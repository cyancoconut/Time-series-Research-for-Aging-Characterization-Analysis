VERSION ""

NS_ :

BS_:

BU_: Inspectrum Master
VAL_TABLE_ Read_Value 0 "Read" ;
VAL_TABLE_ Read_Reset_Values 1 "Reset" 0 "Read" ;
VAL_TABLE_ Error_Flag 1 "Error" 0 "No Error" ;
VAL_TABLE_ Serial_Number_Values 73 "I" 69 "E" 57 "9" 56 "8" 55 "7" 54 "6" 53 "5" 52 "4" 51 "3" 50 "2" 49 "1" 48 "0" ;
VAL_TABLE_ Multiplexer_Status_IDs_Write 16 "Multiplexer Channel" 4 "Enable Multiplexer Scale Sequ." 3 "Enable Multiplexer Sequence" ;
VAL_TABLE_ Multiplexer_Status_IDs_Read 16 "Multiplexer Channel" 4 "Multiplexer Scale Sequ. Enabled" 3 "Multiplexer Sequence Enabled" 2 "Multiplexer Channel Count" 1 "Multiplexer Available" ;
VAL_TABLE_ Multiplexer_Available 1 "Multiplexer Available" 0 "No Multiplexer Available" ;
VAL_TABLE_ Clipping_Flag 1 "Clipping" 0 "No Clipping" ;
VAL_TABLE_ Result_ID_Read 4 "Temperature" 127 "Imag Z Component 32" 126 "Imag Z Component 31" 125 "Imag Z Component 30" 124 "Imag Z Component 29" 123 "Imag Z Component 28" 122 "Imag Z Component 27" 121 "Imag Z Component 26" 120 "Imag Z Component 25" 119 "Imag Z Component 24" 118 "Imag Z Component 23" 117 "Imag Z Component 22" 116 "Imag Z Component 21" 115 "Imag Z Component 20" 114 "Imag Z Component 19" 113 "Imag Z Component 18" 112 "Imag Z Component 17" 111 "Imag Z Component 16" 110 "Imag Z Component 15" 109 "Imag Z Component 14" 108 "Imag Z Component 13" 107 "Imag Z Component 12" 106 "Imag Z Component 11" 105 "Imag Z Component 10" 104 "Imag Z Component 9" 103 "Imag Z Component 8" 102 "Imag Z Component 7" 101 "Imag Z Component 6" 100 "Imag Z Component 5" 99 "Imag Z Component 4" 98 "Imag Z Component 3" 97 "Imag Z  Component 2" 96 "Imag Z Component 1" 95 "Real Z Component 32" 94 "Real Z Component 31" 93 "Real Z Component 30" 92 "Real Z Component 29" 91 "Real Z Component 28" 90 "Real Z Component 27" 89 "Real Z Component 26" 88 "Real Z Component 25" 87 "Real Z Component 24" 86 "Real Z Component 23" 85 "Real Z Component 22" 84 "Real Z Component 21" 83 "Real Z Component 20" 82 "Real Z Component 19" 81 "Real Z Component 18" 80 "Real Z Component 17" 79 "Real Z Component 16" 78 "Real Z Component 15" 77 "Real Z Component 14" 76 "Real Z Component 13" 75 "Real Z Component 12" 74 "Real Z Component 11" 73 "Real Z Component 10" 72 "Real Z Component 9" 71 "Real Z Component 8" 70 "Real Z Component 7" 69 "Real Z Component 6" 68 "Real Z Component 5" 67 "Real Z Component 4" 66 "Real Z Component 3" 65 "Real Z Component 2" 64 "Real Z Component 1" 63 "Frequency Component 32" 62 "Frequency Component 31" 61 "Frequency Component 30" 60 "Frequency Component 29" 59 "Frequency Component 28" 58 "Frequency Component 27" 57 "Frequency Component 26" 56 "Frequency Component 25" 55 "Frequency Component 24" 54 "Frequency Component 23" 53 "Frequency Component 22" 52 "Frequency Component 21" 51 "Frequency Component 20" 50 "Frequency Component 19" 49 "Frequency Component 18" 48 "Frequency Component 17" 47 "Frequency Component 16" 46 "Frequency Component 15" 45 "Frequency Component 14" 44 "Frequency Component 13" 43 "Frequency Component 12" 42 "Frequency Component 11" 41 "Frequency Component 10" 40 "Frequency Component 9" 39 "Frequency Component 8" 38 "Frequency Component 7" 37 "Frequency Component 6" 36 "Frequency Component 5" 35 "Frequency Component 4" 34 "Frequency Component 3" 33 "Frequency Component 2" 32 "Frequency Component 1" 20 "Excitation Scaling Factor" 19 "Battery Current Peak-Peak" 18 "Battery Voltage Peak-Peak" 17 "Clipping Flag" 16 "Frequency Count" 1 "Battery Voltage" ;
VAL_TABLE_ Enable_Status 1 "Enabled" 0 "Disabled" ;
VAL_TABLE_ Enable_Control 1 "Enable" 0 "Disable" ;
VAL_TABLE_ Parameter_IDs_Write 24 "Discard First Period" 128 "Send Results After Measurement" 127 "Phase Component 32" 126 "Phase Component 31" 125 "Phase Component 30" 124 "Phase Component 29" 123 "Phase Component 28" 122 "Phase Component 27" 121 "Phase Component 26" 120 "Phase Component 25" 119 "Phase Component 24" 118 "Phase Component 23" 117 "Phase Component 22" 116 "Phase Component 21" 115 "Phase Component 20" 114 "Phase Component 19" 113 "Phase Component 18" 112 "Phase Component 17" 111 "Phase Component 16" 110 "Phase Component 15" 109 "Phase Component 14" 108 "Phase Component 13" 107 "Phase Component 12" 106 "Phase Component 11" 105 "Phase Component 10" 104 "Phase Component 9" 103 "Phase Component 8" 102 "Phase Component 7" 101 "Phase Component 6" 100 "Phase Component 5" 99 "Phase Component 4" 98 "Phase Component 3" 97 "Phase Component 2" 96 "Phase Component 1" 95 "Amplitude Component 32" 94 "Amplitude Component 31" 93 "Amplitude Component 30" 92 "Amplitude Component 29" 91 "Amplitude Component 28" 90 "Amplitude Component 27" 89 "Amplitude Component 26" 88 "Amplitude Component 25" 87 "Amplitude Component 24" 86 "Amplitude Component 23" 85 "Amplitude Component 22" 84 "Amplitude Component 21" 83 "Amplitude Component 20" 82 "Amplitude Component 19" 81 "Amplitude Component 18" 80 "Amplitude Component 17" 79 "Amplitude Component 16" 78 "Amplitude Component 15" 77 "Amplitude Component 14" 76 "Amplitude Component 13" 75 "Amplitude Component 12" 74 "Amplitude Component 11" 73 "Amplitude Component 10" 72 "Amplitude Component 9" 71 "Amplitude Component 8" 70 "Amplitude Component 7" 69 "Amplitude Component 6" 68 "Amplitude Component 5" 67 "Amplitude Component 4" 66 "Amplitude Component 3" 65 "Amplitude Component 2" 64 "Amplitude Component 1" 63 "Frequency Component 32" 62 "Frequency Component 31" 61 "Frequency Component 30" 60 "Frequency Component 29" 59 "Frequency Component 28" 58 "Frequency Component 27" 57 "Frequency Component 26" 56 "Frequency Component 25" 55 "Frequency Component 24" 54 "Frequency Component 23" 53 "Frequency Component 22" 52 "Frequency Component 21" 51 "Frequency Component 20" 50 "Frequency Component 19" 49 "Frequency Component 18" 48 "Frequency Component 17" 47 "Frequency Component 16" 46 "Frequency Component 15" 45 "Frequency Component 14" 44 "Frequency Component 13" 43 "Frequency Component 12" 42 "Frequency Component 11" 41 "Frequency Component 10" 40 "Frequency Component 9" 39 "Frequency Component 8" 38 "Frequency Component 7" 37 "Frequency Component 6" 36 "Frequency Component 5" 35 "Frequency Component 4" 34 "Frequency Component 3" 33 "Frequency Component 2" 32 "Frequency Component 1" 23 "Continuous Measurement Period" 22 "Automatic Battery Disconnect" 21 "Automatic Battery Connect" 20 "Adaptive Current Scaling Voltage" 19 "Adaptive Current Scaling" 18 "Period Count of lowest Frequency" 17 "Current Scaling Factor" 16 "Frequency Count" 3 "Soft Limit vMax" 2 "Soft Limit vMin" 1 "Soft Limit iMax" ;
VAL_TABLE_ Error_Reset_Code 42405 "Error Reset Code" ;
VAL_TABLE_ Connection_Control_Values 1 "Connect" 0 "Disconnect" ;
VAL_TABLE_ Measurement_Status_Values 1 "Measurement running" 0 "Measurement not running" ;
VAL_TABLE_ Measurement_Control_Values 1 "Start Measurement" 0 "Stop Measurement" ;
VAL_TABLE_ Device_Status_IDs_Read 32 "Battery Connected/Disconnected" 16 "Cont. Measurement Running" 4 "Temperature Measurement Running" 2 "EIS Measurement Running" 1 "Battery Volt Measurement Running" ;
VAL_TABLE_ Device_Status_IDs_Write 32 "Connect/Disconnect Battery" 16 "Start/Stop Cont. Measurement" 4 "Start Temperature Measurement" 2 "Start/Stop EIS Measurement" 1 "Start Battery Volt Measurement" ;
VAL_TABLE_ Parameter_IDs_Read 24 "Discard First Period" 128 "Send Results After Measurement" 176 "Calibration Date" 163 "Serial Number (Character 13)" 162 "Serial Number (Character 9-12)" 161 "Serial Number (Character 5-8)" 160 "Serial Number (Character 1-4)" 127 "Phase Component 32" 126 "Phase Component 31" 125 "Phase Component 30" 124 "Phase Component 29" 123 "Phase Component 28" 122 "Phase Component 27" 121 "Phase Component 26" 120 "Phase Component 25" 119 "Phase Component 24" 118 "Phase Component 23" 117 "Phase Component 22" 116 "Phase Component 21" 115 "Phase Component 20" 114 "Phase Component 19" 113 "Phase Component 18" 112 "Phase Component 17" 111 "Phase Component 16" 110 "Phase Component 15" 109 "Phase Component 14" 108 "Phase Component 13" 107 "Phase Component 12" 106 "Phase Component 11" 105 "Phase Component 10" 104 "Phase Component 9" 103 "Phase Component 8" 102 "Phase Component 7" 101 "Phase Component 6" 100 "Phase Component 5" 99 "Phase Component 4" 98 "Phase Component 3" 97 "Phase Component 2" 96 "Phase Component 1" 95 "Amplitude Component 32" 94 "Amplitude Component 31" 93 "Amplitude Component 30" 92 "Amplitude Component 29" 91 "Amplitude Component 28" 90 "Amplitude Component 27" 89 "Amplitude Component 26" 88 "Amplitude Component 25" 87 "Amplitude Component 24" 86 "Amplitude Component 23" 85 "Amplitude Component 22" 84 "Amplitude Component 21" 83 "Amplitude Component 20" 82 "Amplitude Component 19" 81 "Amplitude Component 18" 80 "Amplitude Component 17" 79 "Amplitude Component 16" 78 "Amplitude Component 15" 77 "Amplitude Component 14" 76 "Amplitude Component 13" 75 "Amplitude Component 12" 74 "Amplitude Component 11" 73 "Amplitude Component 10" 72 "Amplitude Component 9" 71 "Amplitude Component 8" 70 "Amplitude Component 7" 69 "Amplitude Component 6" 68 "Amplitude Component 5" 67 "Amplitude Component 4" 66 "Amplitude Component 3" 65 "Amplitude Component 2" 64 "Amplitude Component 1" 63 "Frequency Component 32" 62 "Frequency Component 31" 61 "Frequency Component 30" 60 "Frequency Component 29" 59 "Frequency Component 28" 58 "Frequency Component 27" 57 "Frequency Component 26" 56 "Frequency Component 25" 55 "Frequency Component 24" 54 "Frequency Component 23" 53 "Frequency Component 22" 52 "Frequency Component 21" 51 "Frequency Component 20" 50 "Frequency Component 19" 49 "Frequency Component 18" 48 "Frequency Component 17" 47 "Frequency Component 16" 46 "Frequency Component 15" 45 "Frequency Component 14" 44 "Frequency Component 13" 43 "Frequency Component 12" 42 "Frequency Component 11" 41 "Frequency Component 10" 40 "Frequency Component 9" 39 "Frequency Component 8" 38 "Frequency Component 7" 37 "Frequency Component 6" 36 "Frequency Component 5" 35 "Frequency Component 4" 34 "Frequency Component 3" 33 "Frequency Component 2" 32 "Frequency Component 1" 23 "Continuous Measurement Period" 22 "Automatic Battery Disconnect" 21 "Automatic Battery Connect" 20 "Adaptive Current Scaling Voltage" 19 "Adaptive Current Scaling" 18 "Period Count of lowest Frequency" 17 "Current Scaling Factor" 16 "Frequency Count" 3 "Soft Limit vMax" 2 "Soft Limit vMin" 1 "Soft Limit iMax" ;
VAL_TABLE_ Connection_Status_Values 1 "Connected" 0 "Disconnnected" ;
VAL_TABLE_ Connection_Change_Reasons 4 "Power" 2 "CAN" 1 "USB" 0 "No Reason" ;
VAL_TABLE_ Read_Write_Values 1 "Write" 0 "Read" ;

BO_ 3221225472 VECTOR__INDEPENDENT_SIG_MSG: 0 Vector__XXX
 SG_ MultiplexerChannelCount : 0|8@0+ (1,0) [0|0] "" Vector__XXX
 SG_ MultiplexerAvaillable : 0|1@0+ (1,0) [0|0] "Bool" Vector__XXX
 SG_ CalibrationYear : 0|16@0+ (1,0) [0|0] "" Vector__XXX
 SG_ CalibrationMonth : 0|8@0+ (1,0) [0|0] "" Vector__XXX
 SG_ CalibrationDay : 0|8@0+ (1,0) [0|0] "" Vector__XXX
 SG_ Frequency : 0|32@0- (1,0) [0|0] "Hz" Vector__XXX
 SG_ Frequency : 0|32@0- (1,0) [0|0] "Hz" Vector__XXX
 SG_ DeviceSerialNumber8_11 : 0|32@0+ (1,0) [0|0] "Char" Vector__XXX
 SG_ DeviceSerialNumber4_7 : 0|32@0+ (1,0) [0|0] "Char" Vector__XXX
 SG_ DeviceSerialNumber12_15 : 0|32@0+ (1,0) [0|0] "Char" Vector__XXX
 SG_ DeviceSerialNumber0_3 : 0|32@0+ (1,0) [0|0] "Char" Vector__XXX
 SG_ ErrorCode : 0|32@0+ (1,0) [0|0] "" Vector__XXX

BO_ 265 MEASUREMENT_RESULT_READ: 2 Master
 SG_ Read : 0|1@0+ (1,0) [0|0] ""  Inspectrum
 SG_ Result_ID : 15|8@0+ (1,0) [0|0] ""  Inspectrum

BO_ 267 MULTIPLEXER_STATUS_READ_WRITE: 3 Master
 SG_ MultiplexerStatus_ID_Read m0 : 15|8@0+ (1,0) [0|0] ""  Inspectrum
 SG_ MUXScalingFactorSequenceEnable m4 : 16|1@0- (1,0) [0|0] "Bool"  Inspectrum
 SG_ MUXChannelSequenceEnable m3 : 16|1@0- (1,0) [0|0] "Bool"  Inspectrum
 SG_ Read_Write M : 0|1@0+ (1,0) [0|0] ""  Inspectrum
 SG_ MultiplexerChannel m16 : 23|8@0+ (1,0) [0|0] ""  Inspectrum
 SG_ MultiplexerStatus_ID_Write m1M : 15|8@0+ (1,0) [0|0] ""  Inspectrum

BO_ 263 ERROR_READ_RESET: 3 Master
 SG_ Read_Reset M : 0|1@0+ (1,0) [0|0] ""  Inspectrum
 SG_ ZeroBytes m0 : 15|16@0+ (1,0) [0|0] ""  Inspectrum
 SG_ ResetCode_0xA5A5 m1 : 15|16@0+ (1,0) [0|0] ""  Inspectrum

BO_ 261 PARAMETER_READ_WRITE: 6 Master
 SG_ DiscardFirstLeastCommonPeriod m24 : 16|1@0+ (1,0) [0|0] "Bool" Vector__XXX
 SG_ SendResultsAfterMeasurement m128 : 16|1@0+ (1,0) [0|0] "Bool"  Inspectrum
 SG_ Parameter_ID_Read m0 : 15|8@0+ (1,0) [0|0] ""  Inspectrum
 SG_ Phase_9 m104 : 23|32@0- (1,0) [0|0] "Per Unit"  Inspectrum
 SG_ Phase_8 m103 : 23|32@0- (1,0) [0|0] "Per Unit"  Inspectrum
 SG_ Phase_7 m102 : 23|32@0- (1,0) [0|0] "Per Unit"  Inspectrum
 SG_ Phase_6 m101 : 23|32@0- (1,0) [0|0] "Per Unit"  Inspectrum
 SG_ Phase_5 m100 : 23|32@0- (1,0) [0|0] "Per Unit"  Inspectrum
 SG_ Phase_4 m99 : 23|32@0- (1,0) [0|0] "Per Unit"  Inspectrum
 SG_ Phase_32 m127 : 23|32@0- (1,0) [0|0] "Per Unit"  Inspectrum
 SG_ Phase_31 m126 : 23|32@0- (1,0) [0|0] "Per Unit"  Inspectrum
 SG_ Phase_30 m125 : 23|32@0- (1,0) [0|0] "Per Unit"  Inspectrum
 SG_ Phase_3 m98 : 23|32@0- (1,0) [0|0] "Per Unit"  Inspectrum
 SG_ Phase_29 m124 : 23|32@0- (1,0) [0|0] "Per Unit"  Inspectrum
 SG_ Phase_28 m123 : 23|32@0- (1,0) [0|0] "Per Unit"  Inspectrum
 SG_ Phase_27 m122 : 23|32@0- (1,0) [0|0] "Per Unit"  Inspectrum
 SG_ Phase_26 m121 : 23|32@0- (1,0) [0|0] "Per Unit"  Inspectrum
 SG_ Phase_25 m120 : 23|32@0- (1,0) [0|0] "Per Unit"  Inspectrum
 SG_ Phase_24 m119 : 23|32@0- (1,0) [0|0] "Per Unit"  Inspectrum
 SG_ Phase_23 m118 : 23|32@0- (1,0) [0|0] "Per Unit"  Inspectrum
 SG_ Phase_22 m117 : 23|32@0- (1,0) [0|0] "Per Unit"  Inspectrum
 SG_ Phase_21 m116 : 23|32@0- (1,0) [0|0] "Per Unit"  Inspectrum
 SG_ Phase_20 m115 : 23|32@0- (1,0) [0|0] "Per Unit"  Inspectrum
 SG_ Phase_2 m97 : 23|32@0- (1,0) [0|0] "Per Unit"  Inspectrum
 SG_ Phase_19 m114 : 23|32@0- (1,0) [0|0] "Per Unit"  Inspectrum
 SG_ Phase_18 m113 : 23|32@0- (1,0) [0|0] "Per Unit"  Inspectrum
 SG_ Phase_17 m112 : 23|32@0- (1,0) [0|0] "Per Unit"  Inspectrum
 SG_ Phase_16 m111 : 23|32@0- (1,0) [0|0] "Per Unit"  Inspectrum
 SG_ Phase_15 m110 : 23|32@0- (1,0) [0|0] "Per Unit"  Inspectrum
 SG_ Phase_14 m109 : 23|32@0- (1,0) [0|0] "Per Unit"  Inspectrum
 SG_ Phase_13 m108 : 23|32@0- (1,0) [0|0] "Per Unit"  Inspectrum
 SG_ Phase_12 m107 : 23|32@0- (1,0) [0|0] "Per Unit"  Inspectrum
 SG_ Phase_11 m106 : 23|32@0- (1,0) [0|0] "Per Unit"  Inspectrum
 SG_ Phase_10 m105 : 23|32@0- (1,0) [0|0] "Per Unit"  Inspectrum
 SG_ Phase_1 m96 : 23|32@0- (1,0) [0|0] "Per Unit"  Inspectrum
 SG_ Amplitude_9 m72 : 23|32@0- (1,0) [0|0] "A"  Inspectrum
 SG_ Amplitude_8 m71 : 23|32@0- (1,0) [0|0] "A"  Inspectrum
 SG_ Amplitude_7 m70 : 23|32@0- (1,0) [0|0] "A"  Inspectrum
 SG_ Amplitude_6 m69 : 23|32@0- (1,0) [0|0] "A"  Inspectrum
 SG_ Amplitude_5 m68 : 23|32@0- (1,0) [0|0] "A"  Inspectrum
 SG_ Amplitude_4 m67 : 23|32@0- (1,0) [0|0] "A"  Inspectrum
 SG_ Amplitude_32 m95 : 23|32@0- (1,0) [0|0] "A"  Inspectrum
 SG_ Amplitude_31 m94 : 23|32@0- (1,0) [0|0] "A"  Inspectrum
 SG_ Amplitude_30 m93 : 23|32@0- (1,0) [0|0] "A"  Inspectrum
 SG_ Amplitude_3 m66 : 23|32@0- (1,0) [0|0] "A"  Inspectrum
 SG_ Amplitude_29 m92 : 23|32@0- (1,0) [0|0] "A"  Inspectrum
 SG_ Amplitude_28 m91 : 23|32@0- (1,0) [0|0] "A"  Inspectrum
 SG_ Amplitude_27 m90 : 23|32@0- (1,0) [0|0] "A"  Inspectrum
 SG_ Amplitude_26 m89 : 23|32@0- (1,0) [0|0] "A"  Inspectrum
 SG_ Amplitude_25 m88 : 23|32@0- (1,0) [0|0] "A"  Inspectrum
 SG_ Amplitude_24 m87 : 23|32@0- (1,0) [0|0] "A"  Inspectrum
 SG_ Amplitude_23 m86 : 23|32@0- (1,0) [0|0] "A"  Inspectrum
 SG_ Amplitude_22 m85 : 23|32@0- (1,0) [0|0] "A"  Inspectrum
 SG_ Amplitude_21 m84 : 23|32@0- (1,0) [0|0] "A"  Inspectrum
 SG_ Amplitude_20 m83 : 23|32@0- (1,0) [0|0] "A"  Inspectrum
 SG_ Amplitude_2 m65 : 23|32@0- (1,0) [0|0] "A"  Inspectrum
 SG_ Amplitude_19 m82 : 23|32@0- (1,0) [0|0] "A"  Inspectrum
 SG_ Amplitude_18 m81 : 23|32@0- (1,0) [0|0] "A"  Inspectrum
 SG_ Amplitude_17 m80 : 23|32@0- (1,0) [0|0] "A"  Inspectrum
 SG_ Amplitude_16 m79 : 23|32@0- (1,0) [0|0] "A"  Inspectrum
 SG_ Amplitude_15 m78 : 23|32@0- (1,0) [0|0] "A"  Inspectrum
 SG_ Amplitude_14 m77 : 23|32@0- (1,0) [0|0] "A"  Inspectrum
 SG_ Amplitude_13 m76 : 23|32@0- (1,0) [0|0] "A"  Inspectrum
 SG_ Amplitude_12 m75 : 23|32@0- (1,0) [0|0] "A"  Inspectrum
 SG_ Amplitude_11 m74 : 23|32@0- (1,0) [0|0] "A"  Inspectrum
 SG_ Amplitude_10 m73 : 23|32@0- (1,0) [0|0] "A"  Inspectrum
 SG_ Amplitude_1 m64 : 23|32@0- (1,0) [0|0] "A"  Inspectrum
 SG_ Frequency_9 m40 : 23|32@0- (1,0) [0|0] "Hz"  Inspectrum
 SG_ Frequency_8 m39 : 23|32@0- (1,0) [0|0] "Hz"  Inspectrum
 SG_ Frequency_7 m38 : 23|32@0- (1,0) [0|0] "Hz"  Inspectrum
 SG_ Frequency_6 m37 : 23|32@0- (1,0) [0|0] "Hz"  Inspectrum
 SG_ Frequency_5 m36 : 23|32@0- (1,0) [0|0] "Hz"  Inspectrum
 SG_ Frequency_4 m35 : 23|32@0- (1,0) [0|0] "Hz"  Inspectrum
 SG_ Frequency_32 m63 : 23|32@0- (1,0) [0|0] "Hz"  Inspectrum
 SG_ Frequency_31 m62 : 23|32@0- (1,0) [0|0] "Hz"  Inspectrum
 SG_ Frequency_30 m61 : 23|32@0- (1,0) [0|0] "Hz"  Inspectrum
 SG_ Frequency_3 m34 : 23|32@0- (1,0) [0|0] "Hz"  Inspectrum
 SG_ Frequency_29 m60 : 23|32@0- (1,0) [0|0] "Hz"  Inspectrum
 SG_ Frequency_28 m59 : 23|32@0- (1,0) [0|0] "Hz"  Inspectrum
 SG_ Frequency_27 m58 : 23|32@0- (1,0) [0|0] "Hz"  Inspectrum
 SG_ Frequency_26 m57 : 23|32@0- (1,0) [0|0] "Hz"  Inspectrum
 SG_ Frequency_25 m56 : 23|32@0- (1,0) [0|0] "Hz"  Inspectrum
 SG_ Frequency_24 m55 : 23|32@0- (1,0) [0|0] "Hz"  Inspectrum
 SG_ Frequency_23 m54 : 23|32@0- (1,0) [0|0] "Hz"  Inspectrum
 SG_ Frequency_22 m53 : 23|32@0- (1,0) [0|0] "Hz"  Inspectrum
 SG_ Frequency_21 m52 : 23|32@0- (1,0) [0|0] "Hz"  Inspectrum
 SG_ Frequency_20 m51 : 23|32@0- (1,0) [0|0] "Hz"  Inspectrum
 SG_ Frequency_2 m33 : 23|32@0- (1,0) [0|0] "Hz"  Inspectrum
 SG_ Frequency_19 m50 : 23|32@0- (1,0) [0|0] "Hz"  Inspectrum
 SG_ Frequency_18 m49 : 23|32@0- (1,0) [0|0] "Hz"  Inspectrum
 SG_ Frequency_17 m48 : 23|32@0- (1,0) [0|0] "Hz"  Inspectrum
 SG_ Frequency_16 m47 : 23|32@0- (1,0) [0|0] "Hz"  Inspectrum
 SG_ Frequency_15 m46 : 23|32@0- (1,0) [0|0] "Hz"  Inspectrum
 SG_ Frequency_14 m45 : 23|32@0- (1,0) [0|0] "Hz"  Inspectrum
 SG_ Frequency_13 m44 : 23|32@0- (1,0) [0|0] "Hz"  Inspectrum
 SG_ Frequency_12 m43 : 23|32@0- (1,0) [0|0] "Hz"  Inspectrum
 SG_ Frequency_11 m42 : 23|32@0- (1,0) [0|0] "Hz"  Inspectrum
 SG_ Frequency_10 m41 : 23|32@0- (1,0) [0|0] "Hz"  Inspectrum
 SG_ Frequency_1 m32 : 23|32@0- (1,0) [0|0] "Hz"  Inspectrum
 SG_ SoftLimitVMax m3 : 23|32@0- (1,0) [0|0] "V"  Inspectrum
 SG_ FrequencyCount m16 : 23|8@0+ (1,0) [0|0] ""  Inspectrum
 SG_ Read_Write M : 0|1@0+ (1,0) [0|0] ""  Inspectrum
 SG_ PeriodCountLowestFreq m18 : 23|32@0+ (1,0) [0|0] ""  Inspectrum
 SG_ AutomaticBatteryDisconnect m22 : 16|1@0+ (1,0) [0|0] "Bool"  Inspectrum
 SG_ AutomaticBatteryConnect m21 : 16|1@0+ (1,0) [0|0] "Bool"  Inspectrum
 SG_ AdaptiveCurrentScalingV m20 : 23|32@0- (1,0) [0|0] "V"  Inspectrum
 SG_ AdaptiveCurrentScaling m19 : 16|1@0+ (1,0) [0|0] "Bool"  Inspectrum
 SG_ CurrentScalingFactor m17 : 23|32@0- (1,0) [0|0] ""  Inspectrum
 SG_ ContinuousMeasurementPeriod m23 : 23|32@0+ (1,0) [0|0] "s"  Inspectrum
 SG_ SoftLimitVMin m2 : 23|32@0- (1,0) [0|0] "V"  Inspectrum
 SG_ SoftLimitIMax m1 : 23|32@0- (1,0) [0|0] "A"  Inspectrum
 SG_ Parameter_ID_Write m1M : 15|8@0+ (1,0) [0|0] ""  Inspectrum

BO_ 259 DEVICE_STATUS_READ_WRITE: 3 Master
 SG_ DeviceStatus_ID_Read m0 : 15|8@0+ (1,0) [0|0] ""  Inspectrum
 SG_ Read_Write M : 0|1@0+ (1,0) [0|0] ""  Inspectrum
 SG_ StartStop_EIS_Measurement m2 : 16|1@0+ (1,0) [0|1] "Bool"  Inspectrum
 SG_ StartStop_Continuous_Measurement m16 : 16|1@0+ (1,0) [0|1] "Bool"  Inspectrum
 SG_ Start_Voltage_Measurement m1 : 16|1@0+ (1,0) [0|1] "Bool"  Inspectrum
 SG_ Start_Temperature_Measurement m4 : 16|1@0+ (1,0) [0|0] "Bool"  Inspectrum
 SG_ Connect_Disconnect_Battery m32 : 16|1@0+ (1,0) [0|0] "Bool"  Inspectrum
 SG_ DeviceStatus_ID_Write m1M : 15|8@0+ (1,0) [0|0] ""  Inspectrum

BO_ 258 CONNECTION_STATUS_VALUE: 2 Inspectrum
 SG_ Connection_Change_Reason : 10|3@0+ (1,0) [0|0] ""  Master
 SG_ Connected_Disconnected : 0|1@0+ (1,0) [0|0] ""  Master

BO_ 257 CONNECTION_STATUS_READ_WRITE: 2 Master
 SG_ ZeroByte m0 : 15|8@0+ (1,0) [0|0] ""  Inspectrum
 SG_ Connect_Disconnect m1 : 8|1@0+ (1,0) [0|0] ""  Inspectrum
 SG_ Read_Write M : 0|1@0+ (1,0) [0|0] ""  Inspectrum

BO_ 260 DEVICE_STATUS_VALUE: 2 Inspectrum
 SG_ DeviceStatus_ID M : 7|8@0+ (1,0) [0|0] ""  Master
 SG_ Voltage_Measurement_Running m1 : 8|1@0+ (1,0) [0|1] "Bool"  Master
 SG_ Temperature_Measurement_Running m4 : 8|1@0+ (1,0) [0|1] "Bool"  Master
 SG_ EIS_Measurement_Running m2 : 8|1@0+ (1,0) [0|1] "Bool"  Master
 SG_ Continuous_Measurement_Running m16 : 8|1@0+ (1,0) [0|1] "Bool"  Master
 SG_ Battery_Connected_Disconnected m32 : 8|1@0+ (1,0) [0|1] "Bool"  Master

BO_ 262 PARAMETER_VALUE: 5 Inspectrum
 SG_ DiscardFirstLeastCommonPeriod m24 : 8|1@0+ (1,0) [0|0] "Bool" Vector__XXX
 SG_ SendResultsAfterMeasurement m128 : 8|1@0+ (1,0) [0|0] "Bool"  Master
 SG_ DeviceSerialNumber_Char9 m162 : 15|8@0+ (1,0) [0|0] "Char"  Master
 SG_ DeviceSerialNumber_Char8 m161 : 39|8@0+ (1,0) [0|0] "Char"  Master
 SG_ DeviceSerialNumber_Char7 m161 : 31|8@0+ (1,0) [0|0] "Char"  Master
 SG_ DeviceSerialNumber_Char6 m161 : 23|8@0+ (1,0) [0|0] "Char"  Master
 SG_ DeviceSerialNumber_Char5 m161 : 15|8@0+ (1,0) [0|0] "Char"  Master
 SG_ DeviceSerialNumber_Char4 m160 : 39|8@0+ (1,0) [0|0] "Char"  Master
 SG_ DeviceSerialNumber_Char3 m160 : 31|8@0+ (1,0) [0|0] "Char"  Master
 SG_ DeviceSerialNumber_Char2 m160 : 23|8@0+ (1,0) [0|0] "Char"  Master
 SG_ DeviceSerialNumber_Char13 m163 : 15|8@0+ (1,0) [0|0] "Char"  Master
 SG_ DeviceSerialNumber_Char12 m162 : 39|8@0+ (1,0) [0|0] "Char"  Master
 SG_ DeviceSerialNumber_Char11 m162 : 31|8@0+ (1,0) [0|0] "Char"  Master
 SG_ DeviceSerialNumber_Char10 m162 : 23|8@0+ (1,0) [0|0] "Char"  Master
 SG_ DeviceSerialNumber_Char1 m160 : 15|8@0+ (1,0) [0|0] "Char"  Master
 SG_ Phase_9 m104 : 15|32@0- (1,0) [0|0] "Per Unit"  Master
 SG_ Phase_8 m103 : 15|32@0- (1,0) [0|0] "Per Unit"  Master
 SG_ Phase_7 m102 : 15|32@0- (1,0) [0|0] "Per Unit"  Master
 SG_ Phase_6 m101 : 15|32@0- (1,0) [0|0] "Per Unit"  Master
 SG_ Phase_5 m100 : 15|32@0- (1,0) [0|0] "Per Unit"  Master
 SG_ Phase_4 m99 : 15|32@0- (1,0) [0|0] "Per Unit"  Master
 SG_ Phase_32 m127 : 15|32@0- (1,0) [0|0] "Per Unit"  Master
 SG_ Phase_31 m126 : 15|32@0- (1,0) [0|0] "Per Unit"  Master
 SG_ Phase_30 m125 : 15|32@0- (1,0) [0|0] "Per Unit"  Master
 SG_ Phase_3 m98 : 15|32@0- (1,0) [0|0] "Per Unit"  Master
 SG_ Phase_29 m124 : 15|32@0- (1,0) [0|0] "Per Unit"  Master
 SG_ Phase_28 m123 : 15|32@0- (1,0) [0|0] "Per Unit"  Master
 SG_ Phase_27 m122 : 15|32@0- (1,0) [0|0] "Per Unit"  Master
 SG_ Phase_26 m121 : 15|32@0- (1,0) [0|0] "Per Unit"  Master
 SG_ Phase_25 m120 : 15|32@0- (1,0) [0|0] "Per Unit"  Master
 SG_ Phase_24 m119 : 15|32@0- (1,0) [0|0] "Per Unit"  Master
 SG_ Phase_23 m118 : 15|32@0- (1,0) [0|0] "Per Unit"  Master
 SG_ Phase_22 m117 : 15|32@0- (1,0) [0|0] "Per Unit"  Master
 SG_ Phase_21 m116 : 15|32@0- (1,0) [0|0] "Per Unit"  Master
 SG_ Phase_20 m115 : 15|32@0- (1,0) [0|0] "Per Unit"  Master
 SG_ Phase_2 m97 : 15|32@0- (1,0) [0|0] "Per Unit"  Master
 SG_ Phase_19 m114 : 15|32@0- (1,0) [0|0] "Per Unit"  Master
 SG_ Phase_18 m113 : 15|32@0- (1,0) [0|0] "Per Unit"  Master
 SG_ Phase_17 m112 : 15|32@0- (1,0) [0|0] "Per Unit"  Master
 SG_ Phase_16 m111 : 15|32@0- (1,0) [0|0] "Per Unit"  Master
 SG_ Phase_15 m110 : 15|32@0- (1,0) [0|0] "Per Unit"  Master
 SG_ Phase_14 m109 : 15|32@0- (1,0) [0|0] "Per Unit"  Master
 SG_ Phase_13 m108 : 15|32@0- (1,0) [0|0] "Per Unit"  Master
 SG_ Phase_12 m107 : 15|32@0- (1,0) [0|0] "Per Unit"  Master
 SG_ Phase_11 m106 : 15|32@0- (1,0) [0|0] "Per Unit"  Master
 SG_ Phase_10 m105 : 15|32@0- (1,0) [0|0] "Per Unit"  Master
 SG_ Phase_1 m96 : 15|32@0- (1,0) [0|0] "Per Unit"  Master
 SG_ Amplitude_9 m72 : 15|32@0- (1,0) [0|0] "A"  Master
 SG_ Amplitude_8 m71 : 15|32@0- (1,0) [0|0] "A"  Master
 SG_ Amplitude_7 m70 : 15|32@0- (1,0) [0|0] "A"  Master
 SG_ Amplitude_6 m69 : 15|32@0- (1,0) [0|0] "A"  Master
 SG_ Amplitude_5 m68 : 15|32@0- (1,0) [0|0] "A"  Master
 SG_ Amplitude_4 m67 : 15|32@0- (1,0) [0|0] "A"  Master
 SG_ Amplitude_32 m95 : 15|32@0- (1,0) [0|0] "A"  Master
 SG_ Amplitude_31 m94 : 15|32@0- (1,0) [0|0] "A"  Master
 SG_ Amplitude_30 m93 : 15|32@0- (1,0) [0|0] "A"  Master
 SG_ Amplitude_3 m66 : 15|32@0- (1,0) [0|0] "A"  Master
 SG_ Amplitude_29 m92 : 15|32@0- (1,0) [0|0] "A"  Master
 SG_ Amplitude_28 m91 : 15|32@0- (1,0) [0|0] "A"  Master
 SG_ Amplitude_27 m90 : 15|32@0- (1,0) [0|0] "A"  Master
 SG_ Amplitude_26 m89 : 15|32@0- (1,0) [0|0] "A"  Master
 SG_ Amplitude_25 m88 : 15|32@0- (1,0) [0|0] "A"  Master
 SG_ Amplitude_24 m87 : 15|32@0- (1,0) [0|0] "A"  Master
 SG_ Amplitude_23 m86 : 15|32@0- (1,0) [0|0] "A"  Master
 SG_ Amplitude_22 m85 : 15|32@0- (1,0) [0|0] "A"  Master
 SG_ Amplitude_21 m84 : 15|32@0- (1,0) [0|0] "A"  Master
 SG_ Amplitude_20 m83 : 15|32@0- (1,0) [0|0] "A"  Master
 SG_ Amplitude_2 m65 : 15|32@0- (1,0) [0|0] "A"  Master
 SG_ Amplitude_19 m82 : 15|32@0- (1,0) [0|0] "A"  Master
 SG_ Amplitude_18 m81 : 15|32@0- (1,0) [0|0] "A"  Master
 SG_ Amplitude_17 m80 : 15|32@0- (1,0) [0|0] "A"  Master
 SG_ Amplitude_16 m79 : 15|32@0- (1,0) [0|0] "A"  Master
 SG_ Amplitude_15 m78 : 15|32@0- (1,0) [0|0] "A"  Master
 SG_ Amplitude_14 m77 : 15|32@0- (1,0) [0|0] "A"  Master
 SG_ Amplitude_13 m76 : 15|32@0- (1,0) [0|0] "A"  Master
 SG_ Amplitude_12 m75 : 15|32@0- (1,0) [0|0] "A"  Master
 SG_ Amplitude_11 m74 : 15|32@0- (1,0) [0|0] "A"  Master
 SG_ Amplitude_10 m73 : 15|32@0- (1,0) [0|0] "A"  Master
 SG_ Amplitude_1 m64 : 15|32@0- (1,0) [0|0] "A"  Master
 SG_ Frequency_9 m40 : 15|32@0- (1,0) [0|0] "Hz"  Master
 SG_ Frequency_8 m39 : 15|32@0- (1,0) [0|0] "Hz"  Master
 SG_ Frequency_7 m38 : 15|32@0- (1,0) [0|0] "Hz"  Master
 SG_ Frequency_6 m37 : 15|32@0- (1,0) [0|0] "Hz"  Master
 SG_ Frequency_5 m36 : 15|32@0- (1,0) [0|0] "Hz"  Master
 SG_ Frequency_4 m35 : 15|32@0- (1,0) [0|0] "Hz"  Master
 SG_ Frequency_32 m63 : 15|32@0- (1,0) [0|0] "Hz"  Master
 SG_ Frequency_31 m62 : 15|32@0- (1,0) [0|0] "Hz"  Master
 SG_ Frequency_30 m61 : 15|32@0- (1,0) [0|0] "Hz"  Master
 SG_ Frequency_3 m34 : 15|32@0- (1,0) [0|0] "Hz"  Master
 SG_ Frequency_29 m60 : 15|32@0- (1,0) [0|0] "Hz"  Master
 SG_ Frequency_28 m59 : 15|32@0- (1,0) [0|0] "Hz"  Master
 SG_ Frequency_27 m58 : 15|32@0- (1,0) [0|0] "Hz"  Master
 SG_ Frequency_26 m57 : 15|32@0- (1,0) [0|0] "Hz"  Master
 SG_ Frequency_25 m56 : 15|32@0- (1,0) [0|0] "Hz"  Master
 SG_ Frequency_24 m55 : 15|32@0- (1,0) [0|0] "Hz"  Master
 SG_ Frequency_23 m54 : 15|32@0- (1,0) [0|0] "Hz"  Master
 SG_ Frequency_22 m53 : 15|32@0- (1,0) [0|0] "Hz"  Master
 SG_ Frequency_21 m52 : 15|32@0- (1,0) [0|0] "Hz"  Master
 SG_ Frequency_20 m51 : 15|32@0- (1,0) [0|0] "Hz"  Master
 SG_ Frequency_2 m33 : 15|32@0- (1,0) [0|0] "Hz"  Master
 SG_ Frequency_19 m50 : 15|32@0- (1,0) [0|0] "Hz"  Master
 SG_ Frequency_18 m49 : 15|32@0- (1,0) [0|0] "Hz"  Master
 SG_ Frequency_17 m48 : 15|32@0- (1,0) [0|0] "Hz"  Master
 SG_ Frequency_16 m47 : 15|32@0- (1,0) [0|0] "Hz"  Master
 SG_ Frequency_15 m46 : 15|32@0- (1,0) [0|0] "Hz"  Master
 SG_ Frequency_14 m45 : 15|32@0- (1,0) [0|0] "Hz"  Master
 SG_ Frequency_13 m44 : 15|32@0- (1,0) [0|0] "Hz"  Master
 SG_ Frequency_12 m43 : 15|32@0- (1,0) [0|0] "Hz"  Master
 SG_ Frequency_11 m42 : 15|32@0- (1,0) [0|0] "Hz"  Master
 SG_ Frequency_10 m41 : 15|32@0- (1,0) [0|0] "Hz"  Master
 SG_ Frequency_1 m32 : 15|32@0- (1,0) [0|0] "Hz"  Master
 SG_ SoftLimitVMin m2 : 15|32@0- (1,0) [0|0] "V"  Master
 SG_ SoftLimitIMax m1 : 15|32@0- (1,0) [0|0] "A"  Master
 SG_ PeriodCountLowestFreq m18 : 15|32@0+ (1,0) [0|0] ""  Master
 SG_ Parameter_ID M : 7|8@0+ (1,0) [0|0] ""  Master
 SG_ CurrentScalingFactor m17 : 15|32@0- (1,0) [0|0] ""  Master
 SG_ ContinuousMeasurementPeriod m23 : 15|32@0+ (1,0) [0|0] "s"  Master
 SG_ AutomaticBatteryDisconnect m22 : 8|1@0+ (1,0) [0|0] "Bool"  Master
 SG_ AutomaticBatteryConnect m21 : 8|1@0+ (1,0) [0|0] "Bool"  Master
 SG_ AdaptiveCurrentScalingV m20 : 15|32@0- (1,0) [0|0] "V"  Master
 SG_ AdaptiveCurrentScaling m19 : 8|1@0+ (1,0) [0|0] "Bool"  Master
 SG_ CalibrationYear m176 : 15|16@0+ (1,0) [0|0] ""  Master
 SG_ CalibrationMonth m176 : 31|8@0+ (1,0) [0|0] ""  Master
 SG_ CalibrationDay m176 : 39|8@0+ (1,0) [0|0] ""  Master
 SG_ FrequencyCount m16 : 15|8@0+ (1,0) [0|0] ""  Master
 SG_ SoftLimitVMax m3 : 15|32@0- (1,0) [0|0] "V"  Master

BO_ 264 ERROR_VALUE: 4 Inspectrum
 SG_ Error_Voltage_Output : 28|1@0+ (1,0) [0|0] "Bool"  Master
 SG_ Error_Voltage_InvertSupply : 26|1@0+ (1,0) [0|0] "Bool"  Master
 SG_ Error_Voltage_HV : 30|1@0+ (1,0) [0|0] "Bool"  Master
 SG_ Error_Voltage_Detection : 18|1@0+ (1,0) [0|0] "Bool"  Master
 SG_ Error_Voltage_BoostSupply : 24|1@0+ (1,0) [0|0] "Bool"  Master
 SG_ Error_User_Configuration : 0|1@0+ (1,0) [0|0] "Bool"  Master
 SG_ Error_Temperature_Sensor : 15|1@0+ (1,0) [0|0] "Bool"  Master
 SG_ Error_Supply_Rails_Offline : 17|1@0+ (1,0) [0|0] "Bool"  Master
 SG_ Error_Reserved_5 : 6|1@0+ (1,0) [0|0] "Bool"  Master
 SG_ Error_Reserved_4 : 5|1@0+ (1,0) [0|0] "Bool"  Master
 SG_ Error_Reserved_3 : 4|1@0+ (1,0) [0|0] "Bool"  Master
 SG_ Error_Reserved_2 : 3|1@0+ (1,0) [0|0] "Bool"  Master
 SG_ Error_Reserved_1 : 13|1@0+ (1,0) [0|0] "Bool"  Master
 SG_ Error_Receive_Timeout : 21|1@0+ (1,0) [0|0] "Bool"  Master
 SG_ Error_Min_Voltage_Limit : 23|1@0+ (1,0) [0|0] "Bool"  Master
 SG_ Error_Measurement_running : 11|1@0+ (1,0) [0|0] "Bool"  Master
 SG_ Error_Max_Voltage_Limit : 8|1@0+ (1,0) [0|0] "Bool"  Master
 SG_ Error_Max_Current_Limit : 22|1@0+ (1,0) [0|0] "Bool"  Master
 SG_ Error_External_Error_Trig : 2|1@0+ (1,0) [0|0] "Bool"  Master
 SG_ Error_External_Emergency_Trig : 14|1@0+ (1,0) [0|0] "Bool"  Master
 SG_ Error_Emergency_Shutdown : 7|1@0+ (1,0) [0|0] "Bool"  Master
 SG_ Error_EEPROM : 31|1@0+ (1,0) [0|0] "Bool"  Master
 SG_ Error_Current_Output : 29|1@0+ (1,0) [0|0] "Bool"  Master
 SG_ Error_Current_InvertSupply : 27|1@0+ (1,0) [0|0] "Bool"  Master
 SG_ Error_Current_BoostSupply : 25|1@0+ (1,0) [0|0] "Bool"  Master
 SG_ Error_Core : 16|1@0+ (1,0) [0|0] "Bool"  Master
 SG_ Error_Calibration : 1|1@0+ (1,0) [0|0] "Bool"  Master
 SG_ Error_Buffer_Overflow : 20|1@0+ (1,0) [0|0] "Bool"  Master
 SG_ Error_Battery_out_of_range : 19|1@0+ (1,0) [0|0] "Bool"  Master
 SG_ Error_Battery_disconnected : 9|1@0+ (1,0) [0|0] "Bool"  Master
 SG_ Error_Battery_connected : 10|1@0+ (1,0) [0|0] "Bool"  Master
 SG_ Error_Aux_Board_Failure : 12|1@0+ (1,0) [0|0] "Bool"  Master

BO_ 268 MULTIPLEXER_STATUS_VALUE: 2 Inspectrum
 SG_ MultiplexerStatus_ID M : 7|8@0+ (1,0) [0|0] ""  Master
 SG_ MultiplexerChannelCount m2 : 15|8@0+ (1,0) [0|0] ""  Master
 SG_ MultiplexerChannel m16 : 15|8@0+ (1,0) [0|0] ""  Master
 SG_ MultiplexerAvaillable m1 : 8|1@0+ (1,0) [0|0] "Bool"  Master
 SG_ MUXScalingFactorSequenceEnabled m4 : 8|1@0+ (1,0) [0|0] "Bool"  Master
 SG_ MUXChannelSequenceEnabled m3 : 8|1@0+ (1,0) [0|0] "Bool"  Master

BO_ 272 USER_MAILBOX_4: 8 Vector__XXX

BO_ 271 USER_MAILBOX_3: 8 Vector__XXX

BO_ 270 USER_MAILBOX_2: 8 Vector__XXX

BO_ 269 USER_MAILBOX_1: 8 Vector__XXX

BO_ 266 MEASUREMENT_RESULT_VALUE: 6 Inspectrum
 SG_ lmZf_9 m104 : 23|32@0- (1,0) [0|0] "Ohm"  Master
 SG_ lmZf_8 m103 : 23|32@0- (1,0) [0|0] "Ohm"  Master
 SG_ lmZf_7 m102 : 23|32@0- (1,0) [0|0] "Ohm"  Master
 SG_ lmZf_6 m101 : 23|32@0- (1,0) [0|0] "Ohm"  Master
 SG_ lmZf_5 m100 : 23|32@0- (1,0) [0|0] "Ohm"  Master
 SG_ lmZf_4 m99 : 23|32@0- (1,0) [0|0] "Ohm"  Master
 SG_ lmZf_32 m127 : 23|32@0- (1,0) [0|0] "Ohm"  Master
 SG_ lmZf_31 m126 : 23|32@0- (1,0) [0|0] "Ohm"  Master
 SG_ lmZf_30 m125 : 23|32@0- (1,0) [0|0] "Ohm"  Master
 SG_ lmZf_3 m98 : 23|32@0- (1,0) [0|0] "Ohm"  Master
 SG_ lmZf_29 m124 : 23|32@0- (1,0) [0|0] "Ohm"  Master
 SG_ lmZf_28 m123 : 23|32@0- (1,0) [0|0] "Ohm"  Master
 SG_ lmZf_27 m122 : 23|32@0- (1,0) [0|0] "Ohm"  Master
 SG_ lmZf_26 m121 : 23|32@0- (1,0) [0|0] "Ohm"  Master
 SG_ lmZf_25 m120 : 23|32@0- (1,0) [0|0] "Ohm"  Master
 SG_ lmZf_24 m119 : 23|32@0- (1,0) [0|0] "Ohm"  Master
 SG_ lmZf_23 m118 : 23|32@0- (1,0) [0|0] "Ohm"  Master
 SG_ lmZf_22 m117 : 23|32@0- (1,0) [0|0] "Ohm"  Master
 SG_ lmZf_21 m116 : 23|32@0- (1,0) [0|0] "Ohm"  Master
 SG_ lmZf_20 m115 : 23|32@0- (1,0) [0|0] "Ohm"  Master
 SG_ lmZf_2 m97 : 23|32@0- (1,0) [0|0] "Ohm"  Master
 SG_ lmZf_19 m114 : 23|32@0- (1,0) [0|0] "Ohm"  Master
 SG_ lmZf_18 m113 : 23|32@0- (1,0) [0|0] "Ohm"  Master
 SG_ lmZf_17 m112 : 23|32@0- (1,0) [0|0] "Ohm"  Master
 SG_ lmZf_16 m111 : 23|32@0- (1,0) [0|0] "Ohm"  Master
 SG_ lmZf_15 m110 : 23|32@0- (1,0) [0|0] "Ohm"  Master
 SG_ lmZf_14 m109 : 23|32@0- (1,0) [0|0] "Ohm"  Master
 SG_ lmZf_13 m108 : 23|32@0- (1,0) [0|0] "Ohm"  Master
 SG_ lmZf_12 m107 : 23|32@0- (1,0) [0|0] "Ohm"  Master
 SG_ lmZf_11 m106 : 23|32@0- (1,0) [0|0] "Ohm"  Master
 SG_ lmZf_10 m105 : 23|32@0- (1,0) [0|0] "Ohm"  Master
 SG_ lmZf_1 m96 : 23|32@0- (1,0) [0|0] "Ohm"  Master
 SG_ ReZf_9 m72 : 23|32@0- (1,0) [0|0] "Ohm"  Master
 SG_ ReZf_8 m71 : 23|32@0- (1,0) [0|0] "Ohm"  Master
 SG_ ReZf_7 m70 : 23|32@0- (1,0) [0|0] "Ohm"  Master
 SG_ ReZf_6 m69 : 23|32@0- (1,0) [0|0] "Ohm"  Master
 SG_ ReZf_5 m68 : 23|32@0- (1,0) [0|0] "Ohm"  Master
 SG_ ReZf_4 m67 : 23|32@0- (1,0) [0|0] "Ohm"  Master
 SG_ ReZf_32 m95 : 23|32@0- (1,0) [0|0] "Ohm"  Master
 SG_ ReZf_31 m94 : 23|32@0- (1,0) [0|0] "Ohm"  Master
 SG_ ReZf_30 m93 : 23|32@0- (1,0) [0|0] "Ohm"  Master
 SG_ ReZf_3 m66 : 23|32@0- (1,0) [0|0] "Ohm"  Master
 SG_ ReZf_29 m92 : 23|32@0- (1,0) [0|0] "Ohm"  Master
 SG_ ReZf_28 m91 : 23|32@0- (1,0) [0|0] "Ohm"  Master
 SG_ ReZf_27 m90 : 23|32@0- (1,0) [0|0] "Ohm"  Master
 SG_ ReZf_26 m89 : 23|32@0- (1,0) [0|0] "Ohm"  Master
 SG_ ReZf_25 m88 : 23|32@0- (1,0) [0|0] "Ohm"  Master
 SG_ ReZf_24 m87 : 23|32@0- (1,0) [0|0] "Ohm"  Master
 SG_ ReZf_23 m86 : 23|32@0- (1,0) [0|0] "Ohm"  Master
 SG_ ReZf_22 m85 : 23|32@0- (1,0) [0|0] "Ohm"  Master
 SG_ ReZf_21 m84 : 23|32@0- (1,0) [0|0] "Ohm"  Master
 SG_ ReZf_20 m83 : 23|32@0- (1,0) [0|0] "Ohm"  Master
 SG_ ReZf_2 m65 : 23|32@0- (1,0) [0|0] "Ohm"  Master
 SG_ ReZf_19 m82 : 23|32@0- (1,0) [0|0] "Ohm"  Master
 SG_ ReZf_18 m81 : 23|32@0- (1,0) [0|0] "Ohm"  Master
 SG_ ReZf_17 m80 : 23|32@0- (1,0) [0|0] "Ohm"  Master
 SG_ ReZf_16 m79 : 23|32@0- (1,0) [0|0] "Ohm"  Master
 SG_ ReZf_15 m78 : 23|32@0- (1,0) [0|0] "Ohm"  Master
 SG_ ReZf_14 m77 : 23|32@0- (1,0) [0|0] "Ohm"  Master
 SG_ ReZf_13 m76 : 23|32@0- (1,0) [0|0] "Ohm"  Master
 SG_ ReZf_12 m75 : 23|32@0- (1,0) [0|0] "Ohm"  Master
 SG_ ReZf_11 m74 : 23|32@0- (1,0) [0|0] "Ohm"  Master
 SG_ ReZf_10 m73 : 23|32@0- (1,0) [0|0] "Ohm"  Master
 SG_ ReZf_1 m64 : 23|32@0- (1,0) [0|0] "Ohm"  Master
 SG_ Frequency_9 m40 : 23|32@0- (1,0) [0|0] "Hz"  Master
 SG_ Frequency_8 m39 : 23|32@0- (1,0) [0|0] "Hz"  Master
 SG_ Frequency_7 m38 : 23|32@0- (1,0) [0|0] "Hz"  Master
 SG_ Frequency_6 m37 : 23|32@0- (1,0) [0|0] "Hz"  Master
 SG_ Frequency_5 m36 : 23|32@0- (1,0) [0|0] "Hz"  Master
 SG_ Frequency_4 m35 : 23|32@0- (1,0) [0|0] "Hz"  Master
 SG_ Frequency_32 m63 : 23|32@0- (1,0) [0|0] "Hz"  Master
 SG_ Frequency_31 m62 : 23|32@0- (1,0) [0|0] "Hz"  Master
 SG_ Frequency_30 m61 : 23|32@0- (1,0) [0|0] "Hz"  Master
 SG_ Frequency_3 m34 : 23|32@0- (1,0) [0|0] "Hz"  Master
 SG_ Frequency_29 m60 : 23|32@0- (1,0) [0|0] "Hz"  Master
 SG_ Frequency_28 m59 : 23|32@0- (1,0) [0|0] "Hz"  Master
 SG_ Frequency_27 m58 : 23|32@0- (1,0) [0|0] "Hz"  Master
 SG_ Frequency_26 m57 : 23|32@0- (1,0) [0|0] "Hz"  Master
 SG_ Frequency_25 m56 : 23|32@0- (1,0) [0|0] "Hz"  Master
 SG_ Frequency_24 m55 : 23|32@0- (1,0) [0|0] "Hz"  Master
 SG_ Frequency_23 m54 : 23|32@0- (1,0) [0|0] "Hz"  Master
 SG_ Frequency_22 m53 : 23|32@0- (1,0) [0|0] "Hz"  Master
 SG_ Frequency_21 m52 : 23|32@0- (1,0) [0|0] "Hz"  Master
 SG_ Frequency_20 m51 : 23|32@0- (1,0) [0|0] "Hz"  Master
 SG_ Frequency_2 m33 : 23|32@0- (1,0) [0|0] "Hz"  Master
 SG_ Frequency_19 m50 : 23|32@0- (1,0) [0|0] "Hz"  Master
 SG_ Frequency_18 m49 : 23|32@0- (1,0) [0|0] "Hz"  Master
 SG_ Frequency_17 m48 : 23|32@0- (1,0) [0|0] "Hz"  Master
 SG_ Frequency_16 m47 : 23|32@0- (1,0) [0|0] "Hz"  Master
 SG_ Frequency_15 m46 : 23|32@0- (1,0) [0|0] "Hz"  Master
 SG_ Frequency_14 m45 : 23|32@0- (1,0) [0|0] "Hz"  Master
 SG_ Frequency_13 m44 : 23|32@0- (1,0) [0|0] "Hz"  Master
 SG_ Frequency_12 m43 : 23|32@0- (1,0) [0|0] "Hz"  Master
 SG_ Frequency_11 m42 : 23|32@0- (1,0) [0|0] "Hz"  Master
 SG_ Frequency_10 m41 : 23|32@0- (1,0) [0|0] "Hz"  Master
 SG_ Frequency_1 m32 : 23|32@0- (1,0) [0|0] "Hz"  Master
 SG_ MultiplexerChannel : 15|8@0+ (1,0) [0|0] ""  Master
 SG_ FrequencyCount m16 : 23|8@0+ (1,0) [0|0] ""  Master
 SG_ ExcitationScalingFactor m20 : 23|32@0- (1,0) [0|0] ""  Master
 SG_ BatteryVoltage m1 : 23|32@0- (1,0) [0|0] "V"  Master
 SG_ Temperature m4 : 23|32@0- (1,0) [0|0] "°C"  Master
 SG_ Clipping m17 : 16|1@0+ (1,0) [0|0] "Bool"  Master
 SG_ BatteryVoltagePeakPeak m18 : 23|32@0- (1,0) [0|0] "V"  Master
 SG_ BatteryCurrentPeakPeak m19 : 23|32@0- (1,0) [0|0] "A"  Master
 SG_ EndofSpectrum m128 : 23|32@0+ (1,0) [0|0] "-"  Master
 SG_ Result_ID M : 7|8@0+ (1,0) [0|0] ""  Master

CM_ BO_ 3221225472 "This is a message for not used signals, created by Vector CANdb++ DBC OLE DB Provider.";
BA_DEF_  "TemplateVersion" STRING ;
BA_DEF_ BU_  "ICMP_inVLmaxFrame" INT 17 1471;
BA_DEF_ BU_  "ICMP_inVLrma" ENUM  "False","True";
BA_DEF_ BU_  "ICMP_inVLintCheck" ENUM  "False","True";
BA_DEF_ BU_  "ICMP_inVLbag" INT 1 128;
BA_DEF_ BU_  "ICMP_inVLnetSel" ENUM  "NETWORK_NONE","NETWORK_A","NETWORK_B","NETWORK_AB";
BA_DEF_ BU_  "ICMP_inVLid" INT 1 65535;
BA_DEF_ BU_  "ICMP_outVLmaxFrame" INT 17 1471;
BA_DEF_ BU_  "ICMP_outVLbag" INT 1 128;
BA_DEF_ BU_  "ICMP_outVLnetSel" ENUM  "NETWORK_NONE","NETWORK_A","NETWORK_B","NETWORK_AB";
BA_DEF_ BU_  "ICMP_outsubVLid" INT 1 4;
BA_DEF_ BU_  "ICMP_outVLid" INT 1 65535;
BA_DEF_ BU_  "ICMP_destIP" STRING ;
BA_DEF_ BU_  "ICMP_name" STRING ;
BA_DEF_  "VersionMonth" INT 0 12;
BA_DEF_  "VersionWeek" INT 0 52;
BA_DEF_  "VersionDay" INT 0 31;
BA_DEF_ SG_  "AfdxFSaddr" INT 4 8192;
BA_DEF_ SG_  "AfdxFDSaddr" INT 8 8192;
BA_DEF_ SG_  "AfdxSignalType" ENUM  "Boolean","Enumerate","Float","Integer","Opaque","String","Status";
BA_DEF_ BO_  "AfdxTxPortId" INT 1 65535;
BA_DEF_ BO_  "AfdxPortMasterName" STRING ;
BA_DEF_ BO_  "AfdxMsgTxRate" INT 0 0;
BA_DEF_ BO_  "AfdxVLbufSize" INT 1 8192;
BA_DEF_ BO_  "AfdxVLdestUDP" INT 0 65535;
BA_DEF_ BO_  "AfdxVLsrcUDP" INT 0 65535;
BA_DEF_ BO_  "AfdxVLdestIP" STRING ;
BA_DEF_ BO_  "AfdxVLsrcIP" STRING ;
BA_DEF_ BO_  "AfdxVLipFrag" ENUM  "True","False";
BA_DEF_ BO_  "AfdxVLportChar" ENUM  "Unknown","SAP","Sampling","Queuing";
BA_DEF_ BO_  "AfdxVLportType" ENUM  "Unknown","SAP","AFDX Communication Port";
BA_DEF_ BO_  "AfdxVLsubVLId" INT 0 4;
BA_DEF_ BO_  "AfdxVLsubVL" INT 0 4;
BA_DEF_ BO_  "AfdxVLintCheck" ENUM  "True","False";
BA_DEF_ BO_  "AfdxVLrma" STRING ;
BA_DEF_ BO_  "AfdxVLmaxFrame" INT 17 1471;
BA_DEF_ BO_  "AfdxVLbag" INT 1 128;
BA_DEF_ BO_  "AfdxVLnetSel" ENUM  "NETWORK_NONE","NETWORK_A","NETWORK_B","NETWORK_AB";
BA_DEF_ BO_  "AfdxVLname" STRING ;
BA_DEF_ BO_  "AfdxVLid" INT 1 65535;
BA_DEF_ BO_  "AfdxVLportSpeed" INT 10 100;
BA_DEF_ BU_  "AfdxEquipment" STRING ;
BA_DEF_ SG_  "DefaultValue" STRING ;
BA_DEF_  "BusType" STRING ;
BA_DEF_  "ToolVersion" STRING ;
BA_DEF_  "ToolName" STRING ;
BA_DEF_DEF_  "TemplateVersion" "2.2.0.0";
BA_DEF_DEF_  "ICMP_inVLmaxFrame" 1471;
BA_DEF_DEF_  "ICMP_inVLrma" "True";
BA_DEF_DEF_  "ICMP_inVLintCheck" "True";
BA_DEF_DEF_  "ICMP_inVLbag" 128;
BA_DEF_DEF_  "ICMP_inVLnetSel" "NETWORK_AB";
BA_DEF_DEF_  "ICMP_inVLid" 2000;
BA_DEF_DEF_  "ICMP_outVLmaxFrame" 1471;
BA_DEF_DEF_  "ICMP_outVLbag" 128;
BA_DEF_DEF_  "ICMP_outVLnetSel" "NETWORK_AB";
BA_DEF_DEF_  "ICMP_outsubVLid" 1;
BA_DEF_DEF_  "ICMP_outVLid" 1000;
BA_DEF_DEF_  "ICMP_destIP" "0.0.0.0";
BA_DEF_DEF_  "ICMP_name" "ICMP_unnamed";
BA_DEF_DEF_  "VersionMonth" 1;
BA_DEF_DEF_  "VersionWeek" 1;
BA_DEF_DEF_  "VersionDay" 1;
BA_DEF_DEF_  "AfdxFSaddr" 4;
BA_DEF_DEF_  "AfdxFDSaddr" 8;
BA_DEF_DEF_  "AfdxSignalType" "Boolean";
BA_DEF_DEF_  "AfdxTxPortId" 1;
BA_DEF_DEF_  "AfdxPortMasterName" "DBC_default";
BA_DEF_DEF_  "AfdxMsgTxRate" 255;
BA_DEF_DEF_  "AfdxVLbufSize" 2048;
BA_DEF_DEF_  "AfdxVLdestUDP" 1;
BA_DEF_DEF_  "AfdxVLsrcUDP" 1;
BA_DEF_DEF_  "AfdxVLdestIP" "0:0:0:0";
BA_DEF_DEF_  "AfdxVLsrcIP" "0:0:0:0";
BA_DEF_DEF_  "AfdxVLipFrag" "True";
BA_DEF_DEF_  "AfdxVLportChar" "Sampling";
BA_DEF_DEF_  "AfdxVLportType" "AFDX Communication Port";
BA_DEF_DEF_  "AfdxVLsubVLId" 1;
BA_DEF_DEF_  "AfdxVLsubVL" 1;
BA_DEF_DEF_  "AfdxVLintCheck" "True";
BA_DEF_DEF_  "AfdxVLrma" "Active";
BA_DEF_DEF_  "AfdxVLmaxFrame" 1471;
BA_DEF_DEF_  "AfdxVLbag" 128;
BA_DEF_DEF_  "AfdxVLnetSel" "NETWORK_AB";
BA_DEF_DEF_  "AfdxVLname" "DBC_default";
BA_DEF_DEF_  "AfdxVLid" 1;
BA_DEF_DEF_  "AfdxVLportSpeed" 100;
BA_DEF_DEF_  "AfdxEquipment" "<unknown>";
BA_DEF_DEF_  "DefaultValue" "";
BA_DEF_DEF_  "BusType" "AFDX";
BA_DEF_DEF_  "ToolVersion" "x.y.z.n";
BA_DEF_DEF_  "ToolName" "manually";
BA_ "BusType" "CAN";
BA_ "DefaultValue" SG_ 263 ZeroBytes "0";
BA_ "DefaultValue" SG_ 257 ZeroByte "0";
VAL_ 265 Read 0 "Read" ;
VAL_ 265 Result_ID 4 "Temperature" 127 "Imag Z Component 32" 126 "Imag Z Component 31" 125 "Imag Z Component 30" 124 "Imag Z Component 29" 123 "Imag Z Component 28" 122 "Imag Z Component 27" 121 "Imag Z Component 26" 120 "Imag Z Component 25" 119 "Imag Z Component 24" 118 "Imag Z Component 23" 117 "Imag Z Component 22" 116 "Imag Z Component 21" 115 "Imag Z Component 20" 114 "Imag Z Component 19" 113 "Imag Z Component 18" 112 "Imag Z Component 17" 111 "Imag Z Component 16" 110 "Imag Z Component 15" 109 "Imag Z Component 14" 108 "Imag Z Component 13" 107 "Imag Z Component 12" 106 "Imag Z Component 11" 105 "Imag Z Component 10" 104 "Imag Z Component 9" 103 "Imag Z Component 8" 102 "Imag Z Component 7" 101 "Imag Z Component 6" 100 "Imag Z Component 5" 99 "Imag Z Component 4" 98 "Imag Z Component 3" 97 "Imag Z  Component 2" 96 "Imag Z Component 1" 95 "Real Z Component 32" 94 "Real Z Component 31" 93 "Real Z Component 30" 92 "Real Z Component 29" 91 "Real Z Component 28" 90 "Real Z Component 27" 89 "Real Z Component 26" 88 "Real Z Component 25" 87 "Real Z Component 24" 86 "Real Z Component 23" 85 "Real Z Component 22" 84 "Real Z Component 21" 83 "Real Z Component 20" 82 "Real Z Component 19" 81 "Real Z Component 18" 80 "Real Z Component 17" 79 "Real Z Component 16" 78 "Real Z Component 15" 77 "Real Z Component 14" 76 "Real Z Component 13" 75 "Real Z Component 12" 74 "Real Z Component 11" 73 "Real Z Component 10" 72 "Real Z Component 9" 71 "Real Z Component 8" 70 "Real Z Component 7" 69 "Real Z Component 6" 68 "Real Z Component 5" 67 "Real Z Component 4" 66 "Real Z Component 3" 65 "Real Z Component 2" 64 "Real Z Component 1" 63 "Frequency Component 32" 62 "Frequency Component 31" 61 "Frequency Component 30" 60 "Frequency Component 29" 59 "Frequency Component 28" 58 "Frequency Component 27" 57 "Frequency Component 26" 56 "Frequency Component 25" 55 "Frequency Component 24" 54 "Frequency Component 23" 53 "Frequency Component 22" 52 "Frequency Component 21" 51 "Frequency Component 20" 50 "Frequency Component 19" 49 "Frequency Component 18" 48 "Frequency Component 17" 47 "Frequency Component 16" 46 "Frequency Component 15" 45 "Frequency Component 14" 44 "Frequency Component 13" 43 "Frequency Component 12" 42 "Frequency Component 11" 41 "Frequency Component 10" 40 "Frequency Component 9" 39 "Frequency Component 8" 38 "Frequency Component 7" 37 "Frequency Component 6" 36 "Frequency Component 5" 35 "Frequency Component 4" 34 "Frequency Component 3" 33 "Frequency Component 2" 32 "Frequency Component 1" 20 "Excitation Scaling Factor" 19 "Battery Current Peak-Peak" 18 "Battery Voltage Peak-Peak" 17 "Clipping Flag" 16 "Frequency Count" 1 "Battery Voltage" ;
VAL_ 267 MultiplexerStatus_ID_Read 16 "Multiplexer Channel" 4 "Multiplexer Scale Sequ. Enabled" 3 "Multiplexer Sequence Enabled" 2 "Multiplexer Channel Count" 1 "Multiplexer Available" ;
VAL_ 267 MUXScalingFactorSequenceEnable 1 "Enable" 0 "Disable" ;
VAL_ 267 MUXChannelSequenceEnable 1 "Enable" 0 "Disable" ;
VAL_ 267 Read_Write 1 "Write" 0 "Read" ;
VAL_ 267 MultiplexerStatus_ID_Write 16 "Multiplexer Channel" 4 "Enable Multiplexer Scale Sequ." 3 "Enable Multiplexer Sequence" ;
VAL_ 263 Read_Reset 1 "Reset" 0 "Read" ;
VAL_ 263 ZeroBytes 0 "Zero" ;
VAL_ 263 ResetCode_0xA5A5 42405 "Error Reset Code" ;
VAL_ 261 DiscardFirstLeastCommonPeriod 1 "Enabled" 0 "Disabled" ;
VAL_ 261 SendResultsAfterMeasurement 1 "Enable" 0 "Disable" ;
VAL_ 261 Parameter_ID_Read 24 "Discard First Period" 128 "Send Results after Measurements" 176 "Calibration Date" 163 "Serial Number (Character 12)" 162 "Serial Number (Character 8-11)" 161 "Serial Number (Character 4-7)" 160 "Serial Number (Character 1-3)" 127 "Phase Component 32" 126 "Phase Component 31" 125 "Phase Component 30" 124 "Phase Component 29" 123 "Phase Component 28" 122 "Phase Component 27" 121 "Phase Component 26" 120 "Phase Component 25" 119 "Phase Component 24" 118 "Phase Component 23" 117 "Phase Component 22" 116 "Phase Component 21" 115 "Phase Component 20" 114 "Phase Component 19" 113 "Phase Component 18" 112 "Phase Component 17" 111 "Phase Component 16" 110 "Phase Component 15" 109 "Phase Component 14" 108 "Phase Component 13" 107 "Phase Component 12" 106 "Phase Component 11" 105 "Phase Component 10" 104 "Phase Component 9" 103 "Phase Component 8" 102 "Phase Component 7" 101 "Phase Component 6" 100 "Phase Component 5" 99 "Phase Component 4" 98 "Phase Component 3" 97 "Phase Component 2" 96 "Phase Component 1" 95 "Amplitude Component 32" 94 "Amplitude Component 31" 93 "Amplitude Component 30" 92 "Amplitude Component 29" 91 "Amplitude Component 28" 90 "Amplitude Component 27" 89 "Amplitude Component 26" 88 "Amplitude Component 25" 87 "Amplitude Component 24" 86 "Amplitude Component 23" 85 "Amplitude Component 22" 84 "Amplitude Component 21" 83 "Amplitude Component 20" 82 "Amplitude Component 19" 81 "Amplitude Component 18" 80 "Amplitude Component 17" 79 "Amplitude Component 16" 78 "Amplitude Component 15" 77 "Amplitude Component 14" 76 "Amplitude Component 13" 75 "Amplitude Component 12" 74 "Amplitude Component 11" 73 "Amplitude Component 10" 72 "Amplitude Component 9" 71 "Amplitude Component 8" 70 "Amplitude Component 7" 69 "Amplitude Component 6" 68 "Amplitude Component 5" 67 "Amplitude Component 4" 66 "Amplitude Component 3" 65 "Amplitude Component 2" 64 "Amplitude Component 1" 63 "Frequency Component 32" 62 "Frequency Component 31" 61 "Frequency Component 30" 60 "Frequency Component 29" 59 "Frequency Component 28" 58 "Frequency Component 27" 57 "Frequency Component 26" 56 "Frequency Component 25" 55 "Frequency Component 24" 54 "Frequency Component 23" 53 "Frequency Component 22" 52 "Frequency Component 21" 51 "Frequency Component 20" 50 "Frequency Component 19" 49 "Frequency Component 18" 48 "Frequency Component 17" 47 "Frequency Component 16" 46 "Frequency Component 15" 45 "Frequency Component 14" 44 "Frequency Component 13" 43 "Frequency Component 12" 42 "Frequency Component 11" 41 "Frequency Component 10" 40 "Frequency Component 9" 39 "Frequency Component 8" 38 "Frequency Component 7" 37 "Frequency Component 6" 36 "Frequency Component 5" 35 "Frequency Component 4" 34 "Frequency Component 3" 33 "Frequency Component 2" 32 "Frequency Component 1" 23 "Continuous Measurement Period" 22 "Automatic Battery Disconnect" 21 "Automatic Battery Connect" 20 "Adaptive Current Scaling Voltage" 19 "Adaptive Current Scaling" 18 "Period Count of lowest Frequency" 17 "Current Scaling Factor" 16 "Frequency Count" 3 "Soft Limit vMax" 2 "Soft Limit vMin" 1 "Soft Limit iMax" ;
VAL_ 261 Read_Write 1 "Write" 0 "Read" ;
VAL_ 261 AutomaticBatteryDisconnect 1 "Enable" 0 "Disable" ;
VAL_ 261 AutomaticBatteryConnect 1 "Enable" 0 "Disable" ;
VAL_ 261 AdaptiveCurrentScaling 1 "Enable" 0 "Disable" ;
VAL_ 261 Parameter_ID_Write 24 "Discard First Period" 128 "Send Results after Measurement" 127 "Phase Component 32" 126 "Phase Component 31" 125 "Phase Component 30" 124 "Phase Component 29" 123 "Phase Component 28" 122 "Phase Component 27" 121 "Phase Component 26" 120 "Phase Component 25" 119 "Phase Component 24" 118 "Phase Component 23" 117 "Phase Component 22" 116 "Phase Component 21" 115 "Phase Component 20" 114 "Phase Component 19" 113 "Phase Component 18" 112 "Phase Component 17" 111 "Phase Component 16" 110 "Phase Component 15" 109 "Phase Component 14" 108 "Phase Component 13" 107 "Phase Component 12" 106 "Phase Component 11" 105 "Phase Component 10" 104 "Phase Component 9" 103 "Phase Component 8" 102 "Phase Component 7" 101 "Phase Component 6" 100 "Phase Component 5" 99 "Phase Component 4" 98 "Phase Component 3" 97 "Phase Component 2" 96 "Phase Component 1" 95 "Amplitude Component 32" 94 "Amplitude Component 31" 93 "Amplitude Component 30" 92 "Amplitude Component 29" 91 "Amplitude Component 28" 90 "Amplitude Component 27" 89 "Amplitude Component 26" 88 "Amplitude Component 25" 87 "Amplitude Component 24" 86 "Amplitude Component 23" 85 "Amplitude Component 22" 84 "Amplitude Component 21" 83 "Amplitude Component 20" 82 "Amplitude Component 19" 81 "Amplitude Component 18" 80 "Amplitude Component 17" 79 "Amplitude Component 16" 78 "Amplitude Component 15" 77 "Amplitude Component 14" 76 "Amplitude Component 13" 75 "Amplitude Component 12" 74 "Amplitude Component 11" 73 "Amplitude Component 10" 72 "Amplitude Component 9" 71 "Amplitude Component 8" 70 "Amplitude Component 7" 69 "Amplitude Component 6" 68 "Amplitude Component 5" 67 "Amplitude Component 4" 66 "Amplitude Component 3" 65 "Amplitude Component 2" 64 "Amplitude Component 1" 63 "Frequency Component 32" 62 "Frequency Component 31" 61 "Frequency Component 30" 60 "Frequency Component 29" 59 "Frequency Component 28" 58 "Frequency Component 27" 57 "Frequency Component 26" 56 "Frequency Component 25" 55 "Frequency Component 24" 54 "Frequency Component 23" 53 "Frequency Component 22" 52 "Frequency Component 21" 51 "Frequency Component 20" 50 "Frequency Component 19" 49 "Frequency Component 18" 48 "Frequency Component 17" 47 "Frequency Component 16" 46 "Frequency Component 15" 45 "Frequency Component 14" 44 "Frequency Component 13" 43 "Frequency Component 12" 42 "Frequency Component 11" 41 "Frequency Component 10" 40 "Frequency Component 9" 39 "Frequency Component 8" 38 "Frequency Component 7" 37 "Frequency Component 6" 36 "Frequency Component 5" 35 "Frequency Component 4" 34 "Frequency Component 3" 33 "Frequency Component 2" 32 "Frequency Component 1" 23 "Continuous Measurement Period" 22 "Automatic Battery Disconnect" 21 "Automatic Battery Connect" 20 "Adaptive Current Scaling Voltage" 19 "Adaptive Current Scaling" 18 "Period Count of lowest Frequency" 17 "Current Scaling Factor" 16 "Frequency Count" 3 "Soft Limit vMax" 2 "Soft Limit vMin" 1 "Soft Limit iMax" ;
VAL_ 259 DeviceStatus_ID_Read 32 "Battery Connected/Disconnected" 16 "Cont. Measurement Running" 4 "Temperature Measurement Running" 2 "EIS Measurement Running" 1 "Battery Volt Measurement Running" ;
VAL_ 259 Read_Write 1 "Write" 0 "Read" ;
VAL_ 259 StartStop_EIS_Measurement 1 "Start Measurement" 0 "Stop Measurement" ;
VAL_ 259 StartStop_Continuous_Measurement 1 "Start Measurement" 0 "Stop Measurement" ;
VAL_ 259 Start_Voltage_Measurement 1 "Start Measurement" 0 "Stop Measurement" ;
VAL_ 259 Start_Temperature_Measurement 1 "Start Measurement" 0 "Stop Measurement" ;
VAL_ 259 Connect_Disconnect_Battery 1 "Connect" 0 "Disconnect" ;
VAL_ 259 DeviceStatus_ID_Write 32 "Connect/Disconnect Battery" 16 "Start/Stop Cont. Measurement" 4 "Start Temperature Measurement" 2 "Start/Stop EIS Measurement" 1 "Start Battery Volt Measurement" ;
VAL_ 258 Connection_Change_Reason 4 "Power" 2 "CAN" 1 "USB" 0 "No Reason" ;
VAL_ 258 Connected_Disconnected 1 "Connected" 0 "Disconnnected" ;
VAL_ 257 ZeroByte 0 "Zero" ;
VAL_ 257 Connect_Disconnect 1 "Connect" 0 "Disconnect" ;
VAL_ 257 Read_Write 1 "Write" 0 "Read" ;
VAL_ 260 DeviceStatus_ID 32 "Battery Connected/Disconnected" 16 "Cont. Measurement Running" 4 "Temperature Measurement Running" 2 "EIS Measurement Running" 1 "Battery Volt Measurement Running" ;
VAL_ 260 Voltage_Measurement_Running 1 "Measurement running" 0 "Measurement not running" ;
VAL_ 260 Temperature_Measurement_Running 1 "Measurement running" 0 "Measurement not running" ;
VAL_ 260 EIS_Measurement_Running 1 "Measurement running" 0 "Measurement not running" ;
VAL_ 260 Continuous_Measurement_Running 1 "Measurement running" 0 "Measurement not running" ;
VAL_ 260 Battery_Connected_Disconnected 1 "Connected" 0 "Disconnnected" ;
VAL_ 262 DiscardFirstLeastCommonPeriod 1 "Enabled" 0 "Disabled" ;
VAL_ 262 SendResultsAfterMeasurement 1 "Enabled" 0 "Disabled" ;
VAL_ 262 DeviceSerialNumber_Char9 73 "I" 69 "E" 57 "9" 56 "8" 55 "7" 54 "6" 53 "5" 52 "4" 51 "3" 50 "2" 49 "1" 48 "0" ;
VAL_ 262 DeviceSerialNumber_Char8 73 "I" 69 "E" 57 "9" 56 "8" 55 "7" 54 "6" 53 "5" 52 "4" 51 "3" 50 "2" 49 "1" 48 "0" ;
VAL_ 262 DeviceSerialNumber_Char7 73 "I" 69 "E" 57 "9" 56 "8" 55 "7" 54 "6" 53 "5" 52 "4" 51 "3" 50 "2" 49 "1" 48 "0" ;
VAL_ 262 DeviceSerialNumber_Char6 73 "I" 69 "E" 57 "9" 56 "8" 55 "7" 54 "6" 53 "5" 52 "4" 51 "3" 50 "2" 49 "1" 48 "0" ;
VAL_ 262 DeviceSerialNumber_Char5 73 "I" 69 "E" 57 "9" 56 "8" 55 "7" 54 "6" 53 "5" 52 "4" 51 "3" 50 "2" 49 "1" 48 "0" ;
VAL_ 262 DeviceSerialNumber_Char4 73 "I" 69 "E" 57 "9" 56 "8" 55 "7" 54 "6" 53 "5" 52 "4" 51 "3" 50 "2" 49 "1" 48 "0" ;
VAL_ 262 DeviceSerialNumber_Char3 73 "I" 69 "E" 57 "9" 56 "8" 55 "7" 54 "6" 53 "5" 52 "4" 51 "3" 50 "2" 49 "1" 48 "0" ;
VAL_ 262 DeviceSerialNumber_Char2 73 "I" 69 "E" 57 "9" 56 "8" 55 "7" 54 "6" 53 "5" 52 "4" 51 "3" 50 "2" 49 "1" 48 "0" ;
VAL_ 262 DeviceSerialNumber_Char13 73 "I" 69 "E" 57 "9" 56 "8" 55 "7" 54 "6" 53 "5" 52 "4" 51 "3" 50 "2" 49 "1" 48 "0" ;
VAL_ 262 DeviceSerialNumber_Char12 73 "I" 69 "E" 57 "9" 56 "8" 55 "7" 54 "6" 53 "5" 52 "4" 51 "3" 50 "2" 49 "1" 48 "0" ;
VAL_ 262 DeviceSerialNumber_Char11 73 "I" 69 "E" 57 "9" 56 "8" 55 "7" 54 "6" 53 "5" 52 "4" 51 "3" 50 "2" 49 "1" 48 "0" ;
VAL_ 262 DeviceSerialNumber_Char10 73 "I" 69 "E" 57 "9" 56 "8" 55 "7" 54 "6" 53 "5" 52 "4" 51 "3" 50 "2" 49 "1" 48 "0" ;
VAL_ 262 DeviceSerialNumber_Char1 73 "I" 69 "E" 57 "9" 56 "8" 55 "7" 54 "6" 53 "5" 52 "4" 51 "3" 50 "2" 49 "1" 48 "0" ;
VAL_ 262 Parameter_ID 24 "Discard First Period" 128 "Send Results After Measurement" 176 "Calibration Date" 163 "Serial Number (Character 12)" 162 "Serial Number (Character 8-11)" 161 "Serial Number (Character 4-7)" 160 "Serial Number (Character 1-3)" 127 "Phase Component 32" 126 "Phase Component 31" 125 "Phase Component 30" 124 "Phase Component 29" 123 "Phase Component 28" 122 "Phase Component 27" 121 "Phase Component 26" 120 "Phase Component 25" 119 "Phase Component 24" 118 "Phase Component 23" 117 "Phase Component 22" 116 "Phase Component 21" 115 "Phase Component 20" 114 "Phase Component 19" 113 "Phase Component 18" 112 "Phase Component 17" 111 "Phase Component 16" 110 "Phase Component 15" 109 "Phase Component 14" 108 "Phase Component 13" 107 "Phase Component 12" 106 "Phase Component 11" 105 "Phase Component 10" 104 "Phase Component 9" 103 "Phase Component 8" 102 "Phase Component 7" 101 "Phase Component 6" 100 "Phase Component 5" 99 "Phase Component 4" 98 "Phase Component 3" 97 "Phase Component 2" 96 "Phase Component 1" 95 "Amplitude Component 32" 94 "Amplitude Component 31" 93 "Amplitude Component 30" 92 "Amplitude Component 29" 91 "Amplitude Component 28" 90 "Amplitude Component 27" 89 "Amplitude Component 26" 88 "Amplitude Component 25" 87 "Amplitude Component 24" 86 "Amplitude Component 23" 85 "Amplitude Component 22" 84 "Amplitude Component 21" 83 "Amplitude Component 20" 82 "Amplitude Component 19" 81 "Amplitude Component 18" 80 "Amplitude Component 17" 79 "Amplitude Component 16" 78 "Amplitude Component 15" 77 "Amplitude Component 14" 76 "Amplitude Component 13" 75 "Amplitude Component 12" 74 "Amplitude Component 11" 73 "Amplitude Component 10" 72 "Amplitude Component 9" 71 "Amplitude Component 8" 70 "Amplitude Component 7" 69 "Amplitude Component 6" 68 "Amplitude Component 5" 67 "Amplitude Component 4" 66 "Amplitude Component 3" 65 "Amplitude Component 2" 64 "Amplitude Component 1" 63 "Frequency Component 32" 62 "Frequency Component 31" 61 "Frequency Component 30" 60 "Frequency Component 29" 59 "Frequency Component 28" 58 "Frequency Component 27" 57 "Frequency Component 26" 56 "Frequency Component 25" 55 "Frequency Component 24" 54 "Frequency Component 23" 53 "Frequency Component 22" 52 "Frequency Component 21" 51 "Frequency Component 20" 50 "Frequency Component 19" 49 "Frequency Component 18" 48 "Frequency Component 17" 47 "Frequency Component 16" 46 "Frequency Component 15" 45 "Frequency Component 14" 44 "Frequency Component 13" 43 "Frequency Component 12" 42 "Frequency Component 11" 41 "Frequency Component 10" 40 "Frequency Component 9" 39 "Frequency Component 8" 38 "Frequency Component 7" 37 "Frequency Component 6" 36 "Frequency Component 5" 35 "Frequency Component 4" 34 "Frequency Component 3" 33 "Frequency Component 2" 32 "Frequency Component 1" 23 "Continuous Measurement Period" 22 "Automatic Battery Disconnect" 21 "Automatic Battery Connect" 20 "Adaptive Current Scaling Voltage" 19 "Adaptive Current Scaling" 18 "Period Count of lowest Frequency" 17 "Current Scaling Factor" 16 "Frequency Count" 3 "Soft Limit vMax" 2 "Soft Limit vMin" 1 "Soft Limit iMax" ;
VAL_ 262 AutomaticBatteryDisconnect 1 "Enabled" 0 "Disabled" ;
VAL_ 262 AutomaticBatteryConnect 1 "Enabled" 0 "Disabled" ;
VAL_ 262 AdaptiveCurrentScaling 1 "Enabled" 0 "Disabled" ;
VAL_ 264 Error_Voltage_Output 1 "Error" 0 "No Error" ;
VAL_ 264 Error_Voltage_InvertSupply 1 "Error" 0 "No Error" ;
VAL_ 264 Error_Voltage_HV 1 "Error" 0 "No Error" ;
VAL_ 264 Error_Voltage_Detection 1 "Error" 0 "No Error" ;
VAL_ 264 Error_Voltage_BoostSupply 1 "Error" 0 "No Error" ;
VAL_ 264 Error_User_Configuration 1 "Error" 0 "No Error" ;
VAL_ 264 Error_Temperature_Sensor 1 "Error" 0 "No Error" ;
VAL_ 264 Error_Supply_Rails_Offline 1 "Error" 0 "No Error" ;
VAL_ 264 Error_Reserved_5 1 "Error" 0 "No Error" ;
VAL_ 264 Error_Reserved_4 1 "Error" 0 "No Error" ;
VAL_ 264 Error_Reserved_3 1 "Error" 0 "No Error" ;
VAL_ 264 Error_Reserved_2 1 "Error" 0 "No Error" ;
VAL_ 264 Error_Reserved_1 1 "Error" 0 "No Error" ;
VAL_ 264 Error_Receive_Timeout 1 "Error" 0 "No Error" ;
VAL_ 264 Error_Min_Voltage_Limit 1 "Error" 0 "No Error" ;
VAL_ 264 Error_Measurement_running 1 "Error" 0 "No Error" ;
VAL_ 264 Error_Max_Voltage_Limit 1 "Error" 0 "No Error" ;
VAL_ 264 Error_Max_Current_Limit 1 "Error" 0 "No Error" ;
VAL_ 264 Error_External_Error_Trig 1 "Error" 0 "No Error" ;
VAL_ 264 Error_External_Emergency_Trig 1 "Error" 0 "No Error" ;
VAL_ 264 Error_Emergency_Shutdown 1 "Error" 0 "No Error" ;
VAL_ 264 Error_EEPROM 1 "Error" 0 "No Error" ;
VAL_ 264 Error_Current_Output 1 "Error" 0 "No Error" ;
VAL_ 264 Error_Current_InvertSupply 1 "Error" 0 "No Error" ;
VAL_ 264 Error_Current_BoostSupply 1 "Error" 0 "No Error" ;
VAL_ 264 Error_Core 1 "Error" 0 "No Error" ;
VAL_ 264 Error_Calibration 1 "Error" 0 "No Error" ;
VAL_ 264 Error_Buffer_Overflow 1 "Error" 0 "No Error" ;
VAL_ 264 Error_Battery_out_of_range 1 "Error" 0 "No Error" ;
VAL_ 264 Error_Battery_disconnected 1 "Error" 0 "No Error" ;
VAL_ 264 Error_Battery_connected 1 "Error" 0 "No Error" ;
VAL_ 264 Error_Aux_Board_Failure 1 "Error" 0 "No Error" ;
VAL_ 268 MultiplexerStatus_ID 16 "Multiplexer Channel" 4 "Multiplexer Scale Sequ. Enabled" 3 "Multiplexer Sequence Enabled" 2 "Multiplexer Channel Count" 1 "Multiplexer Available" ;
VAL_ 268 MultiplexerAvaillable 1 "Multiplexer Available" 0 "No Multiplexer Available" ;
VAL_ 268 MUXScalingFactorSequenceEnabled 1 "Enabled" 0 "Disabled" ;
VAL_ 268 MUXChannelSequenceEnabled 1 "Enabled" 0 "Disabled" ;
VAL_ 266 Clipping 1 "Clipping" 0 "No Clipping" ;
VAL_ 266 EndofSpectrum 0 "End of Spectrum" ;
VAL_ 266 Result_ID 128 "End of Spectrum" 4 "Temperature" 127 "Imag Z Component 32" 126 "Imag Z Component 31" 125 "Imag Z Component 30" 124 "Imag Z Component 29" 123 "Imag Z Component 28" 122 "Imag Z Component 27" 121 "Imag Z Component 26" 120 "Imag Z Component 25" 119 "Imag Z Component 24" 118 "Imag Z Component 23" 117 "Imag Z Component 22" 116 "Imag Z Component 21" 115 "Imag Z Component 20" 114 "Imag Z Component 19" 113 "Imag Z Component 18" 112 "Imag Z Component 17" 111 "Imag Z Component 16" 110 "Imag Z Component 15" 109 "Imag Z Component 14" 108 "Imag Z Component 13" 107 "Imag Z Component 12" 106 "Imag Z Component 11" 105 "Imag Z Component 10" 104 "Imag Z Component 9" 103 "Imag Z Component 8" 102 "Imag Z Component 7" 101 "Imag Z Component 6" 100 "Imag Z Component 5" 99 "Imag Z Component 4" 98 "Imag Z Component 3" 97 "Imag Z  Component 2" 96 "Imag Z Component 1" 95 "Real Z Component 32" 94 "Real Z Component 31" 93 "Real Z Component 30" 92 "Real Z Component 29" 91 "Real Z Component 28" 90 "Real Z Component 27" 89 "Real Z Component 26" 88 "Real Z Component 25" 87 "Real Z Component 24" 86 "Real Z Component 23" 85 "Real Z Component 22" 84 "Real Z Component 21" 83 "Real Z Component 20" 82 "Real Z Component 19" 81 "Real Z Component 18" 80 "Real Z Component 17" 79 "Real Z Component 16" 78 "Real Z Component 15" 77 "Real Z Component 14" 76 "Real Z Component 13" 75 "Real Z Component 12" 74 "Real Z Component 11" 73 "Real Z Component 10" 72 "Real Z Component 9" 71 "Real Z Component 8" 70 "Real Z Component 7" 69 "Real Z Component 6" 68 "Real Z Component 5" 67 "Real Z Component 4" 66 "Real Z Component 3" 65 "Real Z Component 2" 64 "Real Z Component 1" 63 "Frequency Component 32" 62 "Frequency Component 31" 61 "Frequency Component 30" 60 "Frequency Component 29" 59 "Frequency Component 28" 58 "Frequency Component 27" 57 "Frequency Component 26" 56 "Frequency Component 25" 55 "Frequency Component 24" 54 "Frequency Component 23" 53 "Frequency Component 22" 52 "Frequency Component 21" 51 "Frequency Component 20" 50 "Frequency Component 19" 49 "Frequency Component 18" 48 "Frequency Component 17" 47 "Frequency Component 16" 46 "Frequency Component 15" 45 "Frequency Component 14" 44 "Frequency Component 13" 43 "Frequency Component 12" 42 "Frequency Component 11" 41 "Frequency Component 10" 40 "Frequency Component 9" 39 "Frequency Component 8" 38 "Frequency Component 7" 37 "Frequency Component 6" 36 "Frequency Component 5" 35 "Frequency Component 4" 34 "Frequency Component 3" 33 "Frequency Component 2" 32 "Frequency Component 1" 20 "Excitation Scaling Factor" 19 "Battery Current Peak-Peak" 18 "Battery Voltage Peak-Peak" 17 "Clipping Flag" 16 "Frequency Count" 1 "Battery Voltage" ;
SIG_VALTYPE_ 3221225472 Frequency : 1;
SIG_VALTYPE_ 261 Phase_9 : 1;
SIG_VALTYPE_ 261 Phase_8 : 1;
SIG_VALTYPE_ 261 Phase_7 : 1;
SIG_VALTYPE_ 261 Phase_6 : 1;
SIG_VALTYPE_ 261 Phase_5 : 1;
SIG_VALTYPE_ 261 Phase_4 : 1;
SIG_VALTYPE_ 261 Phase_32 : 1;
SIG_VALTYPE_ 261 Phase_31 : 1;
SIG_VALTYPE_ 261 Phase_30 : 1;
SIG_VALTYPE_ 261 Phase_3 : 1;
SIG_VALTYPE_ 261 Phase_29 : 1;
SIG_VALTYPE_ 261 Phase_28 : 1;
SIG_VALTYPE_ 261 Phase_27 : 1;
SIG_VALTYPE_ 261 Phase_26 : 1;
SIG_VALTYPE_ 261 Phase_25 : 1;
SIG_VALTYPE_ 261 Phase_24 : 1;
SIG_VALTYPE_ 261 Phase_23 : 1;
SIG_VALTYPE_ 261 Phase_22 : 1;
SIG_VALTYPE_ 261 Phase_21 : 1;
SIG_VALTYPE_ 261 Phase_20 : 1;
SIG_VALTYPE_ 261 Phase_2 : 1;
SIG_VALTYPE_ 261 Phase_19 : 1;
SIG_VALTYPE_ 261 Phase_18 : 1;
SIG_VALTYPE_ 261 Phase_17 : 1;
SIG_VALTYPE_ 261 Phase_16 : 1;
SIG_VALTYPE_ 261 Phase_15 : 1;
SIG_VALTYPE_ 261 Phase_14 : 1;
SIG_VALTYPE_ 261 Phase_13 : 1;
SIG_VALTYPE_ 261 Phase_12 : 1;
SIG_VALTYPE_ 261 Phase_11 : 1;
SIG_VALTYPE_ 261 Phase_10 : 1;
SIG_VALTYPE_ 261 Phase_1 : 1;
SIG_VALTYPE_ 261 Amplitude_9 : 1;
SIG_VALTYPE_ 261 Amplitude_8 : 1;
SIG_VALTYPE_ 261 Amplitude_7 : 1;
SIG_VALTYPE_ 261 Amplitude_6 : 1;
SIG_VALTYPE_ 261 Amplitude_5 : 1;
SIG_VALTYPE_ 261 Amplitude_4 : 1;
SIG_VALTYPE_ 261 Amplitude_32 : 1;
SIG_VALTYPE_ 261 Amplitude_31 : 1;
SIG_VALTYPE_ 261 Amplitude_30 : 1;
SIG_VALTYPE_ 261 Amplitude_3 : 1;
SIG_VALTYPE_ 261 Amplitude_29 : 1;
SIG_VALTYPE_ 261 Amplitude_28 : 1;
SIG_VALTYPE_ 261 Amplitude_27 : 1;
SIG_VALTYPE_ 261 Amplitude_26 : 1;
SIG_VALTYPE_ 261 Amplitude_25 : 1;
SIG_VALTYPE_ 261 Amplitude_24 : 1;
SIG_VALTYPE_ 261 Amplitude_23 : 1;
SIG_VALTYPE_ 261 Amplitude_22 : 1;
SIG_VALTYPE_ 261 Amplitude_21 : 1;
SIG_VALTYPE_ 261 Amplitude_20 : 1;
SIG_VALTYPE_ 261 Amplitude_2 : 1;
SIG_VALTYPE_ 261 Amplitude_19 : 1;
SIG_VALTYPE_ 261 Amplitude_18 : 1;
SIG_VALTYPE_ 261 Amplitude_17 : 1;
SIG_VALTYPE_ 261 Amplitude_16 : 1;
SIG_VALTYPE_ 261 Amplitude_15 : 1;
SIG_VALTYPE_ 261 Amplitude_14 : 1;
SIG_VALTYPE_ 261 Amplitude_13 : 1;
SIG_VALTYPE_ 261 Amplitude_12 : 1;
SIG_VALTYPE_ 261 Amplitude_11 : 1;
SIG_VALTYPE_ 261 Amplitude_10 : 1;
SIG_VALTYPE_ 261 Amplitude_1 : 1;
SIG_VALTYPE_ 261 Frequency_9 : 1;
SIG_VALTYPE_ 261 Frequency_8 : 1;
SIG_VALTYPE_ 261 Frequency_7 : 1;
SIG_VALTYPE_ 261 Frequency_6 : 1;
SIG_VALTYPE_ 261 Frequency_5 : 1;
SIG_VALTYPE_ 261 Frequency_4 : 1;
SIG_VALTYPE_ 261 Frequency_32 : 1;
SIG_VALTYPE_ 261 Frequency_31 : 1;
SIG_VALTYPE_ 261 Frequency_30 : 1;
SIG_VALTYPE_ 261 Frequency_3 : 1;
SIG_VALTYPE_ 261 Frequency_29 : 1;
SIG_VALTYPE_ 261 Frequency_28 : 1;
SIG_VALTYPE_ 261 Frequency_27 : 1;
SIG_VALTYPE_ 261 Frequency_26 : 1;
SIG_VALTYPE_ 261 Frequency_25 : 1;
SIG_VALTYPE_ 261 Frequency_24 : 1;
SIG_VALTYPE_ 261 Frequency_23 : 1;
SIG_VALTYPE_ 261 Frequency_22 : 1;
SIG_VALTYPE_ 261 Frequency_21 : 1;
SIG_VALTYPE_ 261 Frequency_20 : 1;
SIG_VALTYPE_ 261 Frequency_2 : 1;
SIG_VALTYPE_ 261 Frequency_19 : 1;
SIG_VALTYPE_ 261 Frequency_18 : 1;
SIG_VALTYPE_ 261 Frequency_17 : 1;
SIG_VALTYPE_ 261 Frequency_16 : 1;
SIG_VALTYPE_ 261 Frequency_15 : 1;
SIG_VALTYPE_ 261 Frequency_14 : 1;
SIG_VALTYPE_ 261 Frequency_13 : 1;
SIG_VALTYPE_ 261 Frequency_12 : 1;
SIG_VALTYPE_ 261 Frequency_11 : 1;
SIG_VALTYPE_ 261 Frequency_10 : 1;
SIG_VALTYPE_ 261 Frequency_1 : 1;
SIG_VALTYPE_ 261 SoftLimitVMax : 1;
SIG_VALTYPE_ 261 AdaptiveCurrentScalingV : 1;
SIG_VALTYPE_ 261 CurrentScalingFactor : 1;
SIG_VALTYPE_ 261 SoftLimitVMin : 1;
SIG_VALTYPE_ 261 SoftLimitIMax : 1;
SIG_VALTYPE_ 262 Phase_9 : 1;
SIG_VALTYPE_ 262 Phase_8 : 1;
SIG_VALTYPE_ 262 Phase_7 : 1;
SIG_VALTYPE_ 262 Phase_6 : 1;
SIG_VALTYPE_ 262 Phase_5 : 1;
SIG_VALTYPE_ 262 Phase_4 : 1;
SIG_VALTYPE_ 262 Phase_32 : 1;
SIG_VALTYPE_ 262 Phase_31 : 1;
SIG_VALTYPE_ 262 Phase_30 : 1;
SIG_VALTYPE_ 262 Phase_3 : 1;
SIG_VALTYPE_ 262 Phase_29 : 1;
SIG_VALTYPE_ 262 Phase_28 : 1;
SIG_VALTYPE_ 262 Phase_27 : 1;
SIG_VALTYPE_ 262 Phase_26 : 1;
SIG_VALTYPE_ 262 Phase_25 : 1;
SIG_VALTYPE_ 262 Phase_24 : 1;
SIG_VALTYPE_ 262 Phase_23 : 1;
SIG_VALTYPE_ 262 Phase_22 : 1;
SIG_VALTYPE_ 262 Phase_21 : 1;
SIG_VALTYPE_ 262 Phase_20 : 1;
SIG_VALTYPE_ 262 Phase_2 : 1;
SIG_VALTYPE_ 262 Phase_19 : 1;
SIG_VALTYPE_ 262 Phase_18 : 1;
SIG_VALTYPE_ 262 Phase_17 : 1;
SIG_VALTYPE_ 262 Phase_16 : 1;
SIG_VALTYPE_ 262 Phase_15 : 1;
SIG_VALTYPE_ 262 Phase_14 : 1;
SIG_VALTYPE_ 262 Phase_13 : 1;
SIG_VALTYPE_ 262 Phase_12 : 1;
SIG_VALTYPE_ 262 Phase_11 : 1;
SIG_VALTYPE_ 262 Phase_10 : 1;
SIG_VALTYPE_ 262 Phase_1 : 1;
SIG_VALTYPE_ 262 Amplitude_9 : 1;
SIG_VALTYPE_ 262 Amplitude_8 : 1;
SIG_VALTYPE_ 262 Amplitude_7 : 1;
SIG_VALTYPE_ 262 Amplitude_6 : 1;
SIG_VALTYPE_ 262 Amplitude_5 : 1;
SIG_VALTYPE_ 262 Amplitude_4 : 1;
SIG_VALTYPE_ 262 Amplitude_32 : 1;
SIG_VALTYPE_ 262 Amplitude_31 : 1;
SIG_VALTYPE_ 262 Amplitude_30 : 1;
SIG_VALTYPE_ 262 Amplitude_3 : 1;
SIG_VALTYPE_ 262 Amplitude_29 : 1;
SIG_VALTYPE_ 262 Amplitude_28 : 1;
SIG_VALTYPE_ 262 Amplitude_27 : 1;
SIG_VALTYPE_ 262 Amplitude_26 : 1;
SIG_VALTYPE_ 262 Amplitude_25 : 1;
SIG_VALTYPE_ 262 Amplitude_24 : 1;
SIG_VALTYPE_ 262 Amplitude_23 : 1;
SIG_VALTYPE_ 262 Amplitude_22 : 1;
SIG_VALTYPE_ 262 Amplitude_21 : 1;
SIG_VALTYPE_ 262 Amplitude_20 : 1;
SIG_VALTYPE_ 262 Amplitude_2 : 1;
SIG_VALTYPE_ 262 Amplitude_19 : 1;
SIG_VALTYPE_ 262 Amplitude_18 : 1;
SIG_VALTYPE_ 262 Amplitude_17 : 1;
SIG_VALTYPE_ 262 Amplitude_16 : 1;
SIG_VALTYPE_ 262 Amplitude_15 : 1;
SIG_VALTYPE_ 262 Amplitude_14 : 1;
SIG_VALTYPE_ 262 Amplitude_13 : 1;
SIG_VALTYPE_ 262 Amplitude_12 : 1;
SIG_VALTYPE_ 262 Amplitude_11 : 1;
SIG_VALTYPE_ 262 Amplitude_10 : 1;
SIG_VALTYPE_ 262 Amplitude_1 : 1;
SIG_VALTYPE_ 262 Frequency_9 : 1;
SIG_VALTYPE_ 262 Frequency_8 : 1;
SIG_VALTYPE_ 262 Frequency_7 : 1;
SIG_VALTYPE_ 262 Frequency_6 : 1;
SIG_VALTYPE_ 262 Frequency_5 : 1;
SIG_VALTYPE_ 262 Frequency_4 : 1;
SIG_VALTYPE_ 262 Frequency_32 : 1;
SIG_VALTYPE_ 262 Frequency_31 : 1;
SIG_VALTYPE_ 262 Frequency_30 : 1;
SIG_VALTYPE_ 262 Frequency_3 : 1;
SIG_VALTYPE_ 262 Frequency_29 : 1;
SIG_VALTYPE_ 262 Frequency_28 : 1;
SIG_VALTYPE_ 262 Frequency_27 : 1;
SIG_VALTYPE_ 262 Frequency_26 : 1;
SIG_VALTYPE_ 262 Frequency_25 : 1;
SIG_VALTYPE_ 262 Frequency_24 : 1;
SIG_VALTYPE_ 262 Frequency_23 : 1;
SIG_VALTYPE_ 262 Frequency_22 : 1;
SIG_VALTYPE_ 262 Frequency_21 : 1;
SIG_VALTYPE_ 262 Frequency_20 : 1;
SIG_VALTYPE_ 262 Frequency_2 : 1;
SIG_VALTYPE_ 262 Frequency_19 : 1;
SIG_VALTYPE_ 262 Frequency_18 : 1;
SIG_VALTYPE_ 262 Frequency_17 : 1;
SIG_VALTYPE_ 262 Frequency_16 : 1;
SIG_VALTYPE_ 262 Frequency_15 : 1;
SIG_VALTYPE_ 262 Frequency_14 : 1;
SIG_VALTYPE_ 262 Frequency_13 : 1;
SIG_VALTYPE_ 262 Frequency_12 : 1;
SIG_VALTYPE_ 262 Frequency_11 : 1;
SIG_VALTYPE_ 262 Frequency_10 : 1;
SIG_VALTYPE_ 262 Frequency_1 : 1;
SIG_VALTYPE_ 262 SoftLimitVMin : 1;
SIG_VALTYPE_ 262 SoftLimitIMax : 1;
SIG_VALTYPE_ 262 CurrentScalingFactor : 1;
SIG_VALTYPE_ 262 AdaptiveCurrentScalingV : 1;
SIG_VALTYPE_ 262 SoftLimitVMax : 1;
SIG_VALTYPE_ 266 lmZf_9 : 1;
SIG_VALTYPE_ 266 lmZf_8 : 1;
SIG_VALTYPE_ 266 lmZf_7 : 1;
SIG_VALTYPE_ 266 lmZf_6 : 1;
SIG_VALTYPE_ 266 lmZf_5 : 1;
SIG_VALTYPE_ 266 lmZf_4 : 1;
SIG_VALTYPE_ 266 lmZf_32 : 1;
SIG_VALTYPE_ 266 lmZf_31 : 1;
SIG_VALTYPE_ 266 lmZf_30 : 1;
SIG_VALTYPE_ 266 lmZf_3 : 1;
SIG_VALTYPE_ 266 lmZf_29 : 1;
SIG_VALTYPE_ 266 lmZf_28 : 1;
SIG_VALTYPE_ 266 lmZf_27 : 1;
SIG_VALTYPE_ 266 lmZf_26 : 1;
SIG_VALTYPE_ 266 lmZf_25 : 1;
SIG_VALTYPE_ 266 lmZf_24 : 1;
SIG_VALTYPE_ 266 lmZf_23 : 1;
SIG_VALTYPE_ 266 lmZf_22 : 1;
SIG_VALTYPE_ 266 lmZf_21 : 1;
SIG_VALTYPE_ 266 lmZf_20 : 1;
SIG_VALTYPE_ 266 lmZf_2 : 1;
SIG_VALTYPE_ 266 lmZf_19 : 1;
SIG_VALTYPE_ 266 lmZf_18 : 1;
SIG_VALTYPE_ 266 lmZf_17 : 1;
SIG_VALTYPE_ 266 lmZf_16 : 1;
SIG_VALTYPE_ 266 lmZf_15 : 1;
SIG_VALTYPE_ 266 lmZf_14 : 1;
SIG_VALTYPE_ 266 lmZf_13 : 1;
SIG_VALTYPE_ 266 lmZf_12 : 1;
SIG_VALTYPE_ 266 lmZf_11 : 1;
SIG_VALTYPE_ 266 lmZf_10 : 1;
SIG_VALTYPE_ 266 lmZf_1 : 1;
SIG_VALTYPE_ 266 ReZf_9 : 1;
SIG_VALTYPE_ 266 ReZf_8 : 1;
SIG_VALTYPE_ 266 ReZf_7 : 1;
SIG_VALTYPE_ 266 ReZf_6 : 1;
SIG_VALTYPE_ 266 ReZf_5 : 1;
SIG_VALTYPE_ 266 ReZf_4 : 1;
SIG_VALTYPE_ 266 ReZf_32 : 1;
SIG_VALTYPE_ 266 ReZf_31 : 1;
SIG_VALTYPE_ 266 ReZf_30 : 1;
SIG_VALTYPE_ 266 ReZf_3 : 1;
SIG_VALTYPE_ 266 ReZf_29 : 1;
SIG_VALTYPE_ 266 ReZf_28 : 1;
SIG_VALTYPE_ 266 ReZf_27 : 1;
SIG_VALTYPE_ 266 ReZf_26 : 1;
SIG_VALTYPE_ 266 ReZf_25 : 1;
SIG_VALTYPE_ 266 ReZf_24 : 1;
SIG_VALTYPE_ 266 ReZf_23 : 1;
SIG_VALTYPE_ 266 ReZf_22 : 1;
SIG_VALTYPE_ 266 ReZf_21 : 1;
SIG_VALTYPE_ 266 ReZf_20 : 1;
SIG_VALTYPE_ 266 ReZf_2 : 1;
SIG_VALTYPE_ 266 ReZf_19 : 1;
SIG_VALTYPE_ 266 ReZf_18 : 1;
SIG_VALTYPE_ 266 ReZf_17 : 1;
SIG_VALTYPE_ 266 ReZf_16 : 1;
SIG_VALTYPE_ 266 ReZf_15 : 1;
SIG_VALTYPE_ 266 ReZf_14 : 1;
SIG_VALTYPE_ 266 ReZf_13 : 1;
SIG_VALTYPE_ 266 ReZf_12 : 1;
SIG_VALTYPE_ 266 ReZf_11 : 1;
SIG_VALTYPE_ 266 ReZf_10 : 1;
SIG_VALTYPE_ 266 ReZf_1 : 1;
SIG_VALTYPE_ 266 Frequency_9 : 1;
SIG_VALTYPE_ 266 Frequency_8 : 1;
SIG_VALTYPE_ 266 Frequency_7 : 1;
SIG_VALTYPE_ 266 Frequency_6 : 1;
SIG_VALTYPE_ 266 Frequency_5 : 1;
SIG_VALTYPE_ 266 Frequency_4 : 1;
SIG_VALTYPE_ 266 Frequency_32 : 1;
SIG_VALTYPE_ 266 Frequency_31 : 1;
SIG_VALTYPE_ 266 Frequency_30 : 1;
SIG_VALTYPE_ 266 Frequency_3 : 1;
SIG_VALTYPE_ 266 Frequency_29 : 1;
SIG_VALTYPE_ 266 Frequency_28 : 1;
SIG_VALTYPE_ 266 Frequency_27 : 1;
SIG_VALTYPE_ 266 Frequency_26 : 1;
SIG_VALTYPE_ 266 Frequency_25 : 1;
SIG_VALTYPE_ 266 Frequency_24 : 1;
SIG_VALTYPE_ 266 Frequency_23 : 1;
SIG_VALTYPE_ 266 Frequency_22 : 1;
SIG_VALTYPE_ 266 Frequency_21 : 1;
SIG_VALTYPE_ 266 Frequency_20 : 1;
SIG_VALTYPE_ 266 Frequency_2 : 1;
SIG_VALTYPE_ 266 Frequency_19 : 1;
SIG_VALTYPE_ 266 Frequency_18 : 1;
SIG_VALTYPE_ 266 Frequency_17 : 1;
SIG_VALTYPE_ 266 Frequency_16 : 1;
SIG_VALTYPE_ 266 Frequency_15 : 1;
SIG_VALTYPE_ 266 Frequency_14 : 1;
SIG_VALTYPE_ 266 Frequency_13 : 1;
SIG_VALTYPE_ 266 Frequency_12 : 1;
SIG_VALTYPE_ 266 Frequency_11 : 1;
SIG_VALTYPE_ 266 Frequency_10 : 1;
SIG_VALTYPE_ 266 Frequency_1 : 1;
SIG_VALTYPE_ 266 ExcitationScalingFactor : 1;
SIG_VALTYPE_ 266 BatteryVoltage : 1;
SIG_VALTYPE_ 266 Temperature : 1;
SIG_VALTYPE_ 266 BatteryVoltagePeakPeak : 1;
SIG_VALTYPE_ 266 BatteryCurrentPeakPeak : 1;

SG_MUL_VAL_ 267 MultiplexerStatus_ID_Read Read_Write 0-0;
SG_MUL_VAL_ 267 MUXScalingFactorSequenceEnable MultiplexerStatus_ID_Write 4-4;
SG_MUL_VAL_ 267 MUXChannelSequenceEnable MultiplexerStatus_ID_Write 3-3;
SG_MUL_VAL_ 267 MultiplexerChannel MultiplexerStatus_ID_Write 16-16;
SG_MUL_VAL_ 267 MultiplexerStatus_ID_Write Read_Write 1-1;
SG_MUL_VAL_ 261 DiscardFirstLeastCommonPeriod Parameter_ID_Write 24-24;
SG_MUL_VAL_ 261 SendResultsAfterMeasurement Parameter_ID_Write 128-128;
SG_MUL_VAL_ 261 Parameter_ID_Read Read_Write 0-0;
SG_MUL_VAL_ 261 Phase_9 Parameter_ID_Write 104-104;
SG_MUL_VAL_ 261 Phase_8 Parameter_ID_Write 103-103;
SG_MUL_VAL_ 261 Phase_7 Parameter_ID_Write 102-102;
SG_MUL_VAL_ 261 Phase_6 Parameter_ID_Write 101-101;
SG_MUL_VAL_ 261 Phase_5 Parameter_ID_Write 100-100;
SG_MUL_VAL_ 261 Phase_4 Parameter_ID_Write 99-99;
SG_MUL_VAL_ 261 Phase_32 Parameter_ID_Write 127-127;
SG_MUL_VAL_ 261 Phase_31 Parameter_ID_Write 126-126;
SG_MUL_VAL_ 261 Phase_30 Parameter_ID_Write 125-125;
SG_MUL_VAL_ 261 Phase_3 Parameter_ID_Write 98-98;
SG_MUL_VAL_ 261 Phase_29 Parameter_ID_Write 124-124;
SG_MUL_VAL_ 261 Phase_28 Parameter_ID_Write 123-123;
SG_MUL_VAL_ 261 Phase_27 Parameter_ID_Write 122-122;
SG_MUL_VAL_ 261 Phase_26 Parameter_ID_Write 121-121;
SG_MUL_VAL_ 261 Phase_25 Parameter_ID_Write 120-120;
SG_MUL_VAL_ 261 Phase_24 Parameter_ID_Write 119-119;
SG_MUL_VAL_ 261 Phase_23 Parameter_ID_Write 118-118;
SG_MUL_VAL_ 261 Phase_22 Parameter_ID_Write 117-117;
SG_MUL_VAL_ 261 Phase_21 Parameter_ID_Write 116-116;
SG_MUL_VAL_ 261 Phase_20 Parameter_ID_Write 115-115;
SG_MUL_VAL_ 261 Phase_2 Parameter_ID_Write 97-97;
SG_MUL_VAL_ 261 Phase_19 Parameter_ID_Write 114-114;
SG_MUL_VAL_ 261 Phase_18 Parameter_ID_Write 113-113;
SG_MUL_VAL_ 261 Phase_17 Parameter_ID_Write 112-112;
SG_MUL_VAL_ 261 Phase_16 Parameter_ID_Write 111-111;
SG_MUL_VAL_ 261 Phase_15 Parameter_ID_Write 110-110;
SG_MUL_VAL_ 261 Phase_14 Parameter_ID_Write 109-109;
SG_MUL_VAL_ 261 Phase_13 Parameter_ID_Write 108-108;
SG_MUL_VAL_ 261 Phase_12 Parameter_ID_Write 107-107;
SG_MUL_VAL_ 261 Phase_11 Parameter_ID_Write 106-106;
SG_MUL_VAL_ 261 Phase_10 Parameter_ID_Write 105-105;
SG_MUL_VAL_ 261 Phase_1 Parameter_ID_Write 96-96;
SG_MUL_VAL_ 261 Amplitude_9 Parameter_ID_Write 72-72;
SG_MUL_VAL_ 261 Amplitude_8 Parameter_ID_Write 71-71;
SG_MUL_VAL_ 261 Amplitude_7 Parameter_ID_Write 70-70;
SG_MUL_VAL_ 261 Amplitude_6 Parameter_ID_Write 69-69;
SG_MUL_VAL_ 261 Amplitude_5 Parameter_ID_Write 68-68;
SG_MUL_VAL_ 261 Amplitude_4 Parameter_ID_Write 67-67;
SG_MUL_VAL_ 261 Amplitude_32 Parameter_ID_Write 95-95;
SG_MUL_VAL_ 261 Amplitude_31 Parameter_ID_Write 94-94;
SG_MUL_VAL_ 261 Amplitude_30 Parameter_ID_Write 93-93;
SG_MUL_VAL_ 261 Amplitude_3 Parameter_ID_Write 66-66;
SG_MUL_VAL_ 261 Amplitude_29 Parameter_ID_Write 92-92;
SG_MUL_VAL_ 261 Amplitude_28 Parameter_ID_Write 91-91;
SG_MUL_VAL_ 261 Amplitude_27 Parameter_ID_Write 90-90;
SG_MUL_VAL_ 261 Amplitude_26 Parameter_ID_Write 89-89;
SG_MUL_VAL_ 261 Amplitude_25 Parameter_ID_Write 88-88;
SG_MUL_VAL_ 261 Amplitude_24 Parameter_ID_Write 87-87;
SG_MUL_VAL_ 261 Amplitude_23 Parameter_ID_Write 86-86;
SG_MUL_VAL_ 261 Amplitude_22 Parameter_ID_Write 85-85;
SG_MUL_VAL_ 261 Amplitude_21 Parameter_ID_Write 84-84;
SG_MUL_VAL_ 261 Amplitude_20 Parameter_ID_Write 83-83;
SG_MUL_VAL_ 261 Amplitude_2 Parameter_ID_Write 65-65;
SG_MUL_VAL_ 261 Amplitude_19 Parameter_ID_Write 82-82;
SG_MUL_VAL_ 261 Amplitude_18 Parameter_ID_Write 81-81;
SG_MUL_VAL_ 261 Amplitude_17 Parameter_ID_Write 80-80;
SG_MUL_VAL_ 261 Amplitude_16 Parameter_ID_Write 79-79;
SG_MUL_VAL_ 261 Amplitude_15 Parameter_ID_Write 78-78;
SG_MUL_VAL_ 261 Amplitude_14 Parameter_ID_Write 77-77;
SG_MUL_VAL_ 261 Amplitude_13 Parameter_ID_Write 76-76;
SG_MUL_VAL_ 261 Amplitude_12 Parameter_ID_Write 75-75;
SG_MUL_VAL_ 261 Amplitude_11 Parameter_ID_Write 74-74;
SG_MUL_VAL_ 261 Amplitude_10 Parameter_ID_Write 73-73;
SG_MUL_VAL_ 261 Amplitude_1 Parameter_ID_Write 64-64;
SG_MUL_VAL_ 261 Frequency_9 Parameter_ID_Write 40-40;
SG_MUL_VAL_ 261 Frequency_8 Parameter_ID_Write 39-39;
SG_MUL_VAL_ 261 Frequency_7 Parameter_ID_Write 38-38;
SG_MUL_VAL_ 261 Frequency_6 Parameter_ID_Write 37-37;
SG_MUL_VAL_ 261 Frequency_5 Parameter_ID_Write 36-36;
SG_MUL_VAL_ 261 Frequency_4 Parameter_ID_Write 35-35;
SG_MUL_VAL_ 261 Frequency_32 Parameter_ID_Write 63-63;
SG_MUL_VAL_ 261 Frequency_31 Parameter_ID_Write 62-62;
SG_MUL_VAL_ 261 Frequency_30 Parameter_ID_Write 61-61;
SG_MUL_VAL_ 261 Frequency_3 Parameter_ID_Write 34-34;
SG_MUL_VAL_ 261 Frequency_29 Parameter_ID_Write 60-60;
SG_MUL_VAL_ 261 Frequency_28 Parameter_ID_Write 59-59;
SG_MUL_VAL_ 261 Frequency_27 Parameter_ID_Write 58-58;
SG_MUL_VAL_ 261 Frequency_26 Parameter_ID_Write 57-57;
SG_MUL_VAL_ 261 Frequency_25 Parameter_ID_Write 56-56;
SG_MUL_VAL_ 261 Frequency_24 Parameter_ID_Write 55-55;
SG_MUL_VAL_ 261 Frequency_23 Parameter_ID_Write 54-54;
SG_MUL_VAL_ 261 Frequency_22 Parameter_ID_Write 53-53;
SG_MUL_VAL_ 261 Frequency_21 Parameter_ID_Write 52-52;
SG_MUL_VAL_ 261 Frequency_20 Parameter_ID_Write 51-51;
SG_MUL_VAL_ 261 Frequency_2 Parameter_ID_Write 33-33;
SG_MUL_VAL_ 261 Frequency_19 Parameter_ID_Write 50-50;
SG_MUL_VAL_ 261 Frequency_18 Parameter_ID_Write 49-49;
SG_MUL_VAL_ 261 Frequency_17 Parameter_ID_Write 48-48;
SG_MUL_VAL_ 261 Frequency_16 Parameter_ID_Write 47-47;
SG_MUL_VAL_ 261 Frequency_15 Parameter_ID_Write 46-46;
SG_MUL_VAL_ 261 Frequency_14 Parameter_ID_Write 45-45;
SG_MUL_VAL_ 261 Frequency_13 Parameter_ID_Write 44-44;
SG_MUL_VAL_ 261 Frequency_12 Parameter_ID_Write 43-43;
SG_MUL_VAL_ 261 Frequency_11 Parameter_ID_Write 42-42;
SG_MUL_VAL_ 261 Frequency_10 Parameter_ID_Write 41-41;
SG_MUL_VAL_ 261 Frequency_1 Parameter_ID_Write 32-32;
SG_MUL_VAL_ 261 SoftLimitVMax Parameter_ID_Write 3-3;
SG_MUL_VAL_ 261 FrequencyCount Parameter_ID_Write 16-16;
SG_MUL_VAL_ 261 PeriodCountLowestFreq Parameter_ID_Write 18-18;
SG_MUL_VAL_ 261 AutomaticBatteryDisconnect Parameter_ID_Write 22-22;
SG_MUL_VAL_ 261 AutomaticBatteryConnect Parameter_ID_Write 21-21;
SG_MUL_VAL_ 261 AdaptiveCurrentScalingV Parameter_ID_Write 20-20;
SG_MUL_VAL_ 261 AdaptiveCurrentScaling Parameter_ID_Write 19-19;
SG_MUL_VAL_ 261 CurrentScalingFactor Parameter_ID_Write 17-17;
SG_MUL_VAL_ 261 ContinuousMeasurementPeriod Parameter_ID_Write 23-23;
SG_MUL_VAL_ 261 SoftLimitVMin Parameter_ID_Write 2-2;
SG_MUL_VAL_ 261 SoftLimitIMax Parameter_ID_Write 1-1;
SG_MUL_VAL_ 261 Parameter_ID_Write Read_Write 1-1;
SG_MUL_VAL_ 259 DeviceStatus_ID_Read Read_Write 0-0;
SG_MUL_VAL_ 259 StartStop_EIS_Measurement DeviceStatus_ID_Write 2-2;
SG_MUL_VAL_ 259 StartStop_Continuous_Measurement DeviceStatus_ID_Write 16-16;
SG_MUL_VAL_ 259 Start_Voltage_Measurement DeviceStatus_ID_Write 1-1;
SG_MUL_VAL_ 259 Start_Temperature_Measurement DeviceStatus_ID_Write 4-4;
SG_MUL_VAL_ 259 Connect_Disconnect_Battery DeviceStatus_ID_Write 32-32;
SG_MUL_VAL_ 259 DeviceStatus_ID_Write Read_Write 1-1;
